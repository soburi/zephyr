/*
 * Copyright (c) 2025 TOKITA Hiroshi
 *
 * SPDX-License-Identifier: Apache-2.0
 */

/ {
	resources {
		compatible = "test-gpio-basic-api";
		out-gpios = <&pico_header 14 GPIO_ACTIVE_HIGH>;
		in-gpios = <&pico_header 15 GPIO_ACTIVE_HIGH>;
	};
};
