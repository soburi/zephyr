## tests/drivers/build_all/wifi/testcase.yaml
```yaml
common:
  build_only: true
  tags:
    - drivers
    - wifi
tests:
  drivers.wifi.build_all.spi:
    extra_args: DTC_OVERLAY_FILE="spi_devices.overlay"
    extra_configs:
      - CONFIG_SPI=y
    platform_allow:
      - native_sim
      - native_sim/native/64
```

## tests/drivers/display/display_read_write/testcase.yaml
```yaml
# Copyright 2024 (c) TOKITA Hiroshi
# SPDX-License-Identifier: Apache-2.0

common:
  tags:
    - drivers display
  filter: dt_chosen_enabled("zephyr,display")
  timeout: 1000
tests:
  drivers.display.read_write.sdl.argb8888:
    filter: dt_compat_enabled("zephyr,sdl-dc")
    extra_configs:
      - CONFIG_SDL_DISPLAY_DEFAULT_PIXEL_FORMAT_ARGB_8888=y
      - CONFIG_SDL_DISPLAY_USE_SOFTWARE_RENDERER=y
  drivers.display.read_write.sdl.rgb888:
    filter: dt_compat_enabled("zephyr,sdl-dc")
    extra_configs:
      - CONFIG_SDL_DISPLAY_DEFAULT_PIXEL_FORMAT_RGB_888=y
      - CONFIG_SDL_DISPLAY_USE_SOFTWARE_RENDERER=y
  drivers.display.read_write.sdl.mono01:
    filter: dt_compat_enabled("zephyr,sdl-dc")
    extra_configs:
      - CONFIG_SDL_DISPLAY_DEFAULT_PIXEL_FORMAT_MONO01=y
      - CONFIG_SDL_DISPLAY_USE_SOFTWARE_RENDERER=y
  drivers.display.read_write.sdl.mono10:
    filter: dt_compat_enabled("zephyr,sdl-dc")
    extra_configs:
      - CONFIG_SDL_DISPLAY_DEFAULT_PIXEL_FORMAT_MONO10=y
      - CONFIG_SDL_DISPLAY_USE_SOFTWARE_RENDERER=y
  drivers.display.read_write.sdl.rgb565:
    filter: dt_compat_enabled("zephyr,sdl-dc")
    extra_configs:
      - CONFIG_SDL_DISPLAY_DEFAULT_PIXEL_FORMAT_RGB_565=y
      - CONFIG_SDL_DISPLAY_USE_SOFTWARE_RENDERER=y
  drivers.display.read_write.sdl.bgr565:
    filter: dt_compat_enabled("zephyr,sdl-dc")
    extra_configs:
      - CONFIG_SDL_DISPLAY_DEFAULT_PIXEL_FORMAT_BGR_565=y
      - CONFIG_SDL_DISPLAY_USE_SOFTWARE_RENDERER=y
```

## tests/drivers/spi/spi_loopback/boards/rpi_pico.conf
```kconfig
#
# Copyright (c) 2022 TOKITA Hiroshi <tokita.hiroshi@fujitsu.com>
#
# SPDX-License-Identifier: Apache-2.0
#

# enable rpi_pico spi instance for loopback test
CONFIG_SPI_LOOPBACK_DRV_NAME="SPI_0"
CONFIG_SPI_LOOPBACK_CS_CTRL_GPIO_DRV_NAME="GPIO_0"
CONFIG_SPI_LOOPBACK_CS_CTRL_GPIO_PIN=17
CONFIG_SPI_LOOPBACK_CS_GPIO=y
CONFIG_SPI_ASYNC=y
```

## tests/subsys/display/cfb/basic/testcase.yaml
```yaml
# Copyright (c) 2024 TOKITA Hiroshi
# SPDX-License-Identifier: Apache-2.0

common:
  tags:
    - display
    - drivers
    - cfb
  platform_allow:
    - native_sim/native/64
tests:
  display.cfb.basic.mono01:
    extra_configs:
      - CONFIG_SDL_DISPLAY_DEFAULT_PIXEL_FORMAT_MONO01=y
      - CONFIG_SDL_DISPLAY_USE_HARDWARE_ACCELERATOR=n
```

## west.yml
```yaml
# The west manifest file for upstream Zephyr.
#
# The per-installation west configuration file, .west/config, sets the
# path to the project containing this file in the [manifest] section's
# "path" variable.
#
# You are free to create your own manifest files and put them in any
# repository you want, to create your own custom Zephyr installations.
# For example, you could create a manifest file in your own out of
# tree application directory, which would pull this zephyr repository
# in as an ordinary project.
#
# You can pass your manifest repositories to west init when creating a
# new Zephyr installation. See the west documentation for more
# information.

manifest:
  defaults:
    remote: upstream

  remotes:
    - name: upstream
      url-base: https://github.com/zephyrproject-rtos
    - name: babblesim
      url-base: https://github.com/BabbleSim
    - name: soburi
      url-base: https://github.com/soburi

  group-filter: [-babblesim, -optional]

  #
  # Please add items below based on alphabetical order
  # zephyr-keep-sorted-start re(^\s+\- name:)
  projects:
    - name: acpica
      revision: 8d24867bc9c9d81c81eeac59391cda59333affd4
      path: modules/lib/acpica
    - name: cmsis
      revision: 512cc7e895e8491696b61f7ba8066b4a182569b8
      path: modules/hal/cmsis
      groups:
        - hal
    - name: cmsis-dsp
      revision: 97512610ec92058f0119450b9e743eeb7e95b5c8
      path: modules/lib/cmsis-dsp
    - name: cmsis-nn
      revision: e9328d612ea3ea7d0d210d3ac16ea8667c01abdd
      path: modules/lib/cmsis-nn
    - name: cmsis_6
      repo-path: CMSIS_6
      revision: 30a859f44ef8ab4dc8f84b03ed586fd16ccf9d74
      path: modules/hal/cmsis_6
      groups:
        - hal
    - name: edtt
      revision: c282625e694f0b53ea53e13231ea6d2f49411768
      path: tools/edtt
      groups:
        - tools
    - name: fatfs
      revision: f4ead3bf4a6dab3a07d7b5f5315795c073db568d
      path: modules/fs/fatfs
      groups:
        - fs
    - name: hal_renesas
      path: modules/hal/renesas
      revision: a279c14e196cb0904593035888a334dcd2c720bd
      groups:
        - hal
    - name: liblc3
      revision: 48bbd3eacd36e99a57317a0a4867002e0b09e183
      path: modules/lib/liblc3
    - name: libmctp
      revision: b97860e78998551af99931ece149eeffc538bdb1
      path: modules/lib/libmctp
    - name: libmetal
      revision: 91d38634d1882f0a2151966f8c5c230ce1c0de7b
      path: modules/hal/libmetal
      groups:
        - hal
    - name: libsbc
      revision: 8e1beda02acb8972e29e6edbb423f7cafe16e445
      path: modules/lib/libsbc
    - name: littlefs
      path: modules/fs/littlefs
      groups:
        - fs
      revision: 8f5ca347843363882619d8f96c00d8dbd88a8e79
    - name: lora-basics-modem
      revision: 9a14f6772c1d6e303bacb2d594c8063bb804b6ee
      path: modules/lib/lora-basics-modem
    - name: mbedtls
      revision: c5b06d89c9c498d8fc8659ce31f7e53137b6270f
      path: modules/crypto/mbedtls
      groups:
        - crypto
    - name: mcuboot
      revision: f3cc9476e233364031e9ab842290392f260fba82
      path: bootloader/mcuboot
      groups:
        - bootloader
    - name: mipi-sys-t
      path: modules/debug/mipi-sys-t
      groups:
        - debug
      revision: 5a9d6055b62edc54566d6d0034d9daec91749b98
    - name: nanopb
      revision: 5499fd4c9a478f8139eeb07a82c3b4468d6067f7
      path: modules/lib/nanopb
    - name: net-tools
      revision: 64d7acc661ae2772282570f21beab85d02f2f35c
      path: tools/net-tools
      groups:
        - tools
    - name: open-amp
      revision: c30a6d8b92fcebdb797fc1a7698e8729e250f637
      path: modules/lib/open-amp
    - name: openthread
      revision: 2bc7712f57af22058770d1ef131ad3da79a0c764
      path: modules/lib/openthread
    - name: picolibc
      path: modules/lib/picolibc
      revision: ca8b6ebba5226a75545e57a140443168a26ba664
    - name: segger
      revision: 9f08435a79d41133d7046b7c59d1b25929eda450
      path: modules/debug/segger
      groups:
        - debug
    - name: trusted-firmware-a
      revision: 0a29cac8fe0f7bdb835b469d9ea11b8e17377a92
      path: modules/tee/tf-a/trusted-firmware-a
      groups:
        - tee
    - name: trusted-firmware-m
      revision: 04aa7243e04946b5422b124bea9c0675ab6b120f
      path: modules/tee/tf-m/trusted-firmware-m
      groups:
        - tee
    - name: uoscore-uedhoc
      revision: 54abc109c9c0adfd53c70077744c14e454f04f4a
      path: modules/lib/uoscore-uedhoc
    - name: zcbor
      revision: 9b07780aca6fb21f82a241ba386ad9b379809337
      path: modules/lib/zcbor
    - name: zephyr-xenlib
      revision: xs-client
      path: modules/lib/zephyr-xenlib
      remote: soburi
  # zephyr-keep-sorted-stop

  self:
    path: zephyr
    west-commands: scripts/west-commands.yml
    import: submanifests
```
