## drivers/pcie/epc/Kconfig
```kconfig
# Copyright The Zephyr Project Contributors
# SPDX-License-Identifier: Apache-2.0

menuconfig PCIE_EPC
	bool "PCI Endpoint Controller (EPC) framework"
	help
	  Enable the PCI endpoint controller (EPC) and endpoint function
	  (EPF) framework. The framework splits endpoint support into
	  endpoint controller drivers, which program the endpoint hardware,
	  and endpoint function drivers, which implement the behavior of a
	  PCI function exposed to the host.

if PCIE_EPC

module = PCIE_EPC
module-str = pcie_epc
source "subsys/logging/Kconfig.template.log_config"

config PCIE_EPC_INIT_PRIORITY
	int "PCI EPC driver init priority"
	default 80
	help
	  Initialization priority of the PCI EPC drivers. It must be larger
	  than the initialization priority of the PCIe host controller the
	  EPC device is attached to, if any.

config PCIE_EPC_QEMU
	bool "QEMU PCI EPC driver"
	default y
	depends on DT_HAS_QEMU_PCI_EPC_ENABLED
	depends on PCIE
	help
	  Driver for the QEMU PCI endpoint controller device. The device is
	  provided by the out-of-tree QEMU PCI endpoint controller emulation
	  and shows up on the guest PCI bus with vendor ID 0x1b36 and device
	  ID 0x0013.

if PCIE_EPC_QEMU

config PCIE_EPC_QEMU_WINDOW_PAGES
	int "Number of outbound window pages"
	default 1024
	help
	  Capacity, in pages of 4 KiB, of the allocation bitmap backing the
	  outbound memory window of the QEMU EPC device. The usable part of
	  the window is clamped to this size.

config PCIE_EPC_QEMU_DMA_HEAP_SIZE
	int "DMA heap size"
	default 2097152
	help
	  Size in bytes of the heap used to allocate the BAR backing memory
	  of the endpoint functions bound to the QEMU EPC device.

endif # PCIE_EPC_QEMU

endif # PCIE_EPC
```

## drivers/vhost/Kconfig
```kconfig
# SPDX-FileCopyrightText: Copyright (c) 2025 TOKITA Hiroshi
# SPDX-License-Identifier: Apache-2.0

menuconfig VHOST
	bool "VHost (VIRTIO backend) controller drivers"
	help
	  Enable VHost controller drivers. A VHost controller provides the
	  hypervisor-specific transport for implementing VIRTIO device
	  backends that serve VIRTIO drivers running in guest virtual
	  machines.

if VHOST

config VHOST_XEN_MMIO
	bool "Xen MMIO VIRTIO backend controller"
	default y
	depends on DT_HAS_XEN_VHOST_MMIO_ENABLED
	depends on XEN_DOM0
	select XEN_STORE_CLI
	select XEN_DMOP
	help
	  Enable the VHost controller that implements a VIRTIO MMIO device
	  backend on the Xen hypervisor, using the ioreq server interface to
	  emulate the MMIO register window and the grant table interface to
	  access guest buffers.

config VHOST_PCI_EPF
	bool "VIRTIO PCI endpoint function controller"
	default y
	depends on DT_HAS_ZEPHYR_VHOST_PCI_EPF_ENABLED
	depends on PCIE_EPC
	help
	  Enable the VHost controller that exposes a VIRTIO PCI device to the
	  PCI host through a function of a PCI endpoint controller. The
	  function implements the VIRTIO PCI interface, serves the register
	  accesses of the driver, and accesses the driver buffers through the
	  outbound address windows of the endpoint controller. It needs an
	  endpoint controller that services BAR accesses in software.

config VHOST_PCI_EPF_INIT_PRIORITY
	int "VIRTIO PCI endpoint function controller init priority"
	default 90
	depends on VHOST_PCI_EPF
	help
	  Initialization priority of the VIRTIO PCI endpoint function
	  controller. It must be larger than PCIE_EPC_INIT_PRIORITY.

module = VHOST
module-str = VHOST
source "subsys/logging/Kconfig.template.log_config"

endif # VHOST
```

## dts/bindings/pcie/endpoint/qemu,pci-epc.yaml
```yaml
# Copyright The Zephyr Project Contributors
# SPDX-License-Identifier: Apache-2.0

description: |
  QEMU PCI endpoint controller (EPC) device.

  The device is provided by the out-of-tree QEMU PCI endpoint controller
  emulation and shows up on the guest PCI bus with vendor ID 0x1b36 and
  device ID 0x0013. It forwards endpoint operations performed by the guest
  to a PCI endpoint device model on another QEMU instance.

compatible: "qemu,pci-epc"

include: [pcie-epc.yaml, pcie-device.yaml]

properties:
  doorbell-bar:
    type: int
    default: 0
    description: |
      BAR of the endpoint function that holds the doorbell range. The
      default is the first BAR.

  doorbell-offset:
    type: int
    description: |
      Offset of the doorbell range in the BAR. The device model interrupts
      the endpoint when the PCI host writes the range, wherever it lies, so
      set it to the register in which the endpoint function expects its
      notifications. The node needs an interrupts property then. Without
      this property the endpoint controller has no doorbell.

  doorbell-width:
    type: int
    default: 4
    enum: [1, 2, 4]
    description: |
      Width in bytes of the doorbell range. The default is a 32-bit
      register.
```

## dts/bindings/pcie/litex,pcie-epc.yaml
```yaml
# Copyright The Zephyr Project Contributors
# SPDX-License-Identifier: Apache-2.0

description: LitePCIe firmware-controlled inbound BAR0 controller (ABI v1)
compatible: "litex,pcie-epc"
include: pcie-epc.yaml
properties:
  reg:
    required: true
  bar0-size:
    type: int
    required: true
    description: Fixed BAR0 aperture configured in the PCIe hard IP
```

## dts/bindings/pcie/pcie-epc.yaml
```yaml
# Copyright The Zephyr Project Contributors
# SPDX-License-Identifier: Apache-2.0

description: PCIe endpoint controller (EPC) common properties

include: base.yaml

properties:
  max-functions:
    type: int
    required: true
    description: |
      Number of endpoint functions the controller can host. Functions are
      numbered from 0.
```

## dts/bindings/vhost/zephyr,vhost-pci-epf.yaml
```yaml
# Copyright The Zephyr Project Contributors
# SPDX-License-Identifier: Apache-2.0

description: |
  VHost controller exposing a VIRTIO PCI device through a PCI endpoint
  function.

  The controller adds one endpoint function to the PCI endpoint controller
  (EPC) referenced by the epc property. The function implements the VIRTIO
  PCI interface ("Virtio Over PCI Bus" in the VIRTIO specification): VIRTIO
  capabilities that point at the configuration structures in BAR 0. The PCI
  host on the other side of the link drives it with its regular virtio-pci
  driver. The function raises the INTx interrupt; it has no MSI-X
  capability.

  The common configuration banks registers by selectors, so the controller
  serves each host access to BAR 0 in software. It needs an endpoint
  controller that services BARs in software and can add capabilities. It
  handles the accesses on a notification of the endpoint controller or,
  without one, by polling for them.

compatible: "zephyr,vhost-pci-epf"

include: base.yaml

properties:
  epc:
    type: phandle
    required: true
    description: |
      PCI endpoint controller the endpoint function is added to.

  device-id:
    type: int
    required: true
    description: |
      Virtio device ID value, as defined by the VIRTIO Specification, used to
      identify the type of device implemented by this instance.

  num-queues:
    type: int
    default: 1
    description: |
      Number of virtqueues of the device, at most 32.

  queue-size-max:
    type: int
    required: true
    description: |
      Maximum number of entries of a virtqueue. It must be a power of two.
      The driver can select a smaller size.

  max-buffers:
    type: int
    default: 16
    description: |
      Maximum number of driver buffers mapped at the same time, summed over
      all outstanding requests. Each mapped buffer occupies one outbound
      address window of the endpoint controller, and each virtqueue uses
      three more for its rings. The default fits one request made of a full
      16 entry descriptor chain.

  poll-period-ms:
    type: int
    default: 1
    description: |
      Period, in milliseconds, at which the controller polls for host
      accesses to BAR 0 when the endpoint controller does not notify them.
      Each access waits for the poll, so the default favors latency.

  stack-size:
    type: int
    default: 4096
    description: |
      Stack size (in bytes) for the instance-specific work queue thread. The
      default fits the controller and a backend with a shallow call depth.

  priority:
    type: int
    default: 0
    description: |
      Priority for the instance-specific work queue thread. The default is
      the highest preemptible priority.

  config-data:
    type: uint8-array
    description: |
      Device-specific configuration, as described for the device type in the
      VIRTIO Specification.
```
