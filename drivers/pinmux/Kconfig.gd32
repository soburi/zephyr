## drivers/pinmux/Kconfig.gd32
```kconfig
# Configuration for GD32 pinmux

# Copyright (c) 2016 Open-RnD Sp. z o.o.
# SPDX-License-Identifier: Apache-2.0

config PINMUX_GD32
	bool "Pinmux driver for GD32 MCUs"
	#depends on SOC_FAMILY_GD32
	help
	  Enable pin multiplexer for GD32 MCUs

config PINMUX_GD32_DEVICE_INITIALIZATION_PRIORITY
	int "Device initialization priority GD32 pinmux"
	depends on PINMUX_GD32
	default 2
	help
	  This option controls the priority of pinmux device initialization.
	  Higher priority ensures that the device is initialized earlier in
	  the startup cycle. Note that the pinmux device needs to be initialized
	  after clock control device, but possibly before all other devices.
	  If unsure, leave at default value 2
```

## drivers/sdhc/Kconfig.brcm
```kconfig
# Copyright (c) 2024 EPAM Systems
# SPDX-License-Identifier: Apache-2.0

config BRCM_BCM2712_SDHCI
	bool "BCM2712 SDHC (SD/MMC)"
	default y
	depends on DT_HAS_BRCM_BCM2712_SDHCI_ENABLED
	select SDHCI_GENERIC
	select REGULATOR
	select GPIO
	select CACHE_MANAGEMENT
	select SDHC_SUPPORTS_UHS if SDMMC_STACK
	help
	  BCM2712 SDHC v3.0 cpapable.

if BRCM_BCM2712_SDHCI

# SDHC DMA needs 64 bit aligned buffers
config SDHC_BUFFER_ALIGNMENT
	default 64

choice BRCM_BCM2712_XFER_MODE
	bool "Select BCM2712 SDHC (SD/MMC) data transfer mode"
	default BRCM_BCM2712_XFER_SDMA

config BRCM_BCM2712_XFER_PIO
	bool "BCM2712 SDHC PIO data transfer mode"

config BRCM_BCM2712_XFER_SDMA
	bool "BCM2712 SDHC SDMA data transfer mode"

endchoice

endif # BRCM_BCM2712_SDHCI
```

## drivers/sdhc/Kconfig.sdhc
```kconfig
# Copyright (c) 2024 EPAM Systems
# SPDX-License-Identifier: Apache-2.0

config SDHCI_GENERIC
	bool
	select SDHC_SUPPORTS_NATIVE_MODE
	help
	  SD Host Controller (SDHC) generic implementation module according to
	  SD Host Controller Standard Specification (Version 3.0).

config SDHCI_GENERIC_ADMA2_DESC_MAX_LEN
	int "ADMA2 max xfer size per descriptor"
	default 65532
	range 1 65536
	help
	  Defines ADMA2 max xfer size per descriptor. The default value selected by
	  taking into account that some SDHC HW implemtations may not handle
	  properly descriptor "Length Field" == 0 case (65536 bytes xfer).
```

## drivers/sensor/liteon/ltr553/Kconfig
```kconfig
# LTR-553 sensor configuration options

config LTR_553
        bool "LiteOn LTR-553 ambient light and proximity sensor"
        depends on DT_HAS_LITEON_LTR553_ENABLED
        default y
        select I2C
        help
          Enable driver for the LiteOn LTR-553 ambient light and proximity sensor.
```

## drivers/sensor/maxim/max30101/Kconfig
```kconfig
# MAX30101 heart rate sensor

# Copyright (c) 2017, NXP
# SPDX-License-Identifier: Apache-2.0

config MAX301XX
	bool "MAX30101 Pulse Oximeter and Heart Rate Sensor"
	default y
	depends on DT_HAS_MAXIM_MAX30101_ENABLED || \
		   DT_HAS_MAXIM_MAX30102_ENABLED
	select I2C
```

## drivers/serial/Kconfig.gd32
```kconfig
# GD32 UART configuration

# Copyright (c) 2016 Open-RnD Sp. z o.o.
# SPDX-License-Identifier: Apache-2.0

menuconfig UART_GD32
	bool "GD32 MCU serial driver"
	select SERIAL_HAS_DRIVER
	select SERIAL_SUPPORT_INTERRUPT
	depends on SOC_SERIES_RISCV_GIGADEVICE_GD32VF103
	help
	  This option enables the UART driver for GD32 family of
	  processors.
	  Say y if you wish to use serial port on GD32 MCU.

if UART_GD32

# --- port 0 ---

config UART_0
	bool "Enable GD32 USART0 Port"
	help
	  Enable support for USART0 port in the driver.
	  Say y here if you want to use USART1 device.

# --- port 1 ---

config UART_1
	bool "Enable GD32 USART1 Port"
	help
	  Enable support for USART1 port in the driver.
	  Say y here if you want to use USART1 device.

# --- port 2 ---

config UART_2
	bool "Enable GD32 USART2 Port"
	help
	  Enable support for USART2 port in the driver.
	  Say y here if you want to use USART2 device.

# --- port 3 ---

config UART_3
	bool "Enable GD32 USART3 Port"
	help
	  Enable support for USART3 port in the driver.
	  Say y here if you want to use USART3 device.

# --- port 4 ---

config UART_4
	bool "Enable GD32 U(S)ART4 Port"
	help
	  Enable support for U(S)ART4 port in the driver.
	  Say y here if you want to use U(S)ART4 device.

# --- port 5 ---

config UART_5
	bool "Enable GD32 U(S)ART5 Port"
	help
	  Enable support for U(S)ART5 port in the driver.
	  Say y here if you want to use U(S)ART5 device.

# --- port 6 ---

config UART_6
	bool "Enable GD32 USART6 Port"
	help
	  Enable support for USART6 port in the driver.
	  Say y here if you want to use USART6 device.

# --- port 7 ---

config UART_7
	bool "Enable GD32 U(S)ART7 Port"
	help
	  Enable support for U(S)ART7 port in the driver.
	  Say y here if you want to use U(S)ART7 device.

# --- port 8 ---

config UART_8
	bool "Enable GD32 U(S)ART8 Port"
	help
	  Enable support for U(S)ART8 port in the driver.
	  Say y here if you want to use U(S)ART8 device.

# --- port 9 ---

config UART_9
	bool "Enable GD32 UART9 Port"
	help
	  Enable support for UART9 port in the driver.
	  Say y here if you want to use UART9 device.

endif # UART_GD32
```

## drivers/serial/Kconfig.ra
```kconfig
# Copyright (c) 2023 TOKITA Hiroshi <tokita.hiroshi@fujitsu.com>
# SPDX-License-Identifier: Apache-2.0

config UART_RA
	bool "Renesas RA Series UART driver"
	default y
	depends on DT_HAS_RENESAS_RA_UART_SCI_ENABLED
	select SERIAL_HAS_DRIVER
	select USE_FSP_SCI_UART
	help
	  Enable Renesas RA Series UART Driver.
```

## drivers/spi/Kconfig.gd32
```kconfig
# GD32 SPI driver configuration options

# Copyright (c) 2015-2016 Intel Corporation
# SPDX-License-Identifier: Apache-2.0

menuconfig SPI_GD32
	bool "GD32 MCU SPI controller driver"
	#depends on SOC_FAMILY_GD32
	help
	  Enable SPI support on the GD32 family of processors.

if SPI_GD32

config SPI_GD32_HAS_FIFO
	bool
	#depends on (SOC_SERIES_GD32L4X || SOC_SERIES_GD32F0X || \
	#SOC_SERIES_GD32F3X || SOC_SERIES_GD32F7X || SOC_SERIES_GD32MP1X || \
	#SOC_SERIES_GD32WBX || SOC_SERIES_GD32G4X)
	default y

config SPI_GD32_INTERRUPT
	bool "GD32 MCU SPI Interrupt Support"
	help
	  Enable Interrupt support for the SPI Driver of GD32 family.

config SPI_GD32_USE_HW_SS
	bool "GD32 Hardware Slave Select support"
	default y
	help
	  Use Slave Select pin instead of software Slave Select.

endif # SPI_GD32
```

## drivers/spi/Kconfig.pl022
```kconfig
# Copyright (c) 2022 TOKITA Hiroshi <tokita.hiroshi@fujitsu.com>
# SPDX-License-Identifier: Apache-2.0

# Workaround for not being able to have commas in macro arguments
DT_COMPAT_PL022 := arm,pl022

config SPI_PL022
	default $(dt_compat_enabled,$(DT_COMPAT_PL022))
	select SPI_PL022_INTERRUPT if SPI_ASYNC
	bool "ARM PL022 SPI driver"

if SPI_PL022

config SPI_PL022_INTERRUPT
	bool "PL022 interrupt mode"
	help
	  Enables interrupt support for PL022 SPI driver.

endif
```

## drivers/timer/Kconfig.qingke
```kconfig
# Copyright (c) 2023 Chen Xingyu <hi@xingrz.me>
# SPDX-License-Identifier: Apache-2.0

config QINGKE_V3_SYSTICK
	bool "WCH QingKe V3 SysTick"
	default y
	depends on DT_HAS_WCH_QINGKE_V3_SYSTICK_ENABLED
	help
	  Enable WCH QingKe V3 SysTick driver.
```

## dts/bindings/audio/awinic,aw88298.yaml
```yaml
# Copyright (c) 2025 The Zephyr Authors
#
# SPDX-License-Identifier: Apache-2.0

description: Awinic AW88298 smart audio power amplifier

include: [i2c-device.yaml]

compatible: "awinic,aw88298"

properties:
  reg:
    required: true

  reset-gpios:
    type: phandle-array
    description: GPIO used to enable or power the speaker amplifier

  awinic,default-volume:
    type: int
    description: Default playback volume (0-255)
    default: 100
```

## dts/bindings/audio/everest,es7210-dmic.yaml
```yaml
# Copyright 2025 The Zephyr Authors
# SPDX-License-Identifier: Apache-2.0

description: Everest Semiconductor ES7210 digital microphone (I2S)

compatible: "everest,es7210-dmic"

include: i2s-device.yaml

properties:
  codec:
    type: phandle
    required: true
    description: |
      Phandle to a node describing the ES7210 control interface.
      The DMIC driver uses the phandle to access the I2C registers and
      optional clock and microphone configuration properties.

  bit-clock-master:
    type: boolean
    description: >
      Set when the ES7210 provides the I2S bit clock. If unset the SoC drives
      the clock.

  frame-clock-master:
    type: boolean
    description: >
      Set when the ES7210 provides the I2S frame clock. If unset the SoC drives
      the clock.

  bit-clock-inverted:
    type: boolean
    description: Invert the I2S bit clock polarity.

  data-format:
    type: string
    enum:
      - i2s
      - left-justified
      - right-justified
    description: I2S data format provided by the ES7210.

  timeout-ms:
    type: int
    default: 2000
    description: Timeout in milliseconds used for I2S read operations.
```

## dts/bindings/audio/everest,es7210.yaml
```yaml
# Copyright (c) 2025
# SPDX-License-Identifier: Apache-2.0

description: Everest Semiconductor ES7210 audio ADC

compatible: "everest,es7210"

include: [i2c-device.yaml]

properties:
  reg:
    required: true

  reset-gpios:
    type: phandle-array
    description: Optional reset GPIO for the codec.
```

## dts/bindings/clock/gigadevice,gd32-rcu.yaml
```yaml
title: GD32 RCC

description: |
    This binding gives a base representation of the GD32 Clock control

compatible: "gigadevice,gd32-rcu"

include: [clock-controller.yaml, base.yaml]

properties:
    reg:
      required: true

    "#clock-cells":
      const: 2

clock-cells:
  - bus
  - bits
```

## dts/bindings/clock/renesas,ra-clock.yaml
```yaml
# Copyright (c) 2023 TOKITA Hiroshi <tokita.hiroshi@fujitsu.com>
# SPDX-License-Identifier: Apache-2.0

description: Renesas Clock Pulse Generator / Module Standby and Software Reset

compatible: "renesas,ra-clock"

include: [clock-controller.yaml, base.yaml]

properties:
  reg:
    required: true

  "#clock-cells":
    const: 0
```

## dts/bindings/clock/renesas,ra-main-clock.yaml
```yaml
description: Nuvoton NuMaker System Clock Controller (SCC)

compatible: "renesas,ra-system-clock"

include: [fixed-factor-clock.yaml, base.yaml]

properties:
  clock-src:
    type: phandle
    description: |
      System clock source
```

## dts/bindings/clock/renesas,rcar-cpg-mssr-emul.yaml
```yaml
# Copyright (c) 2025 TOKITA Hiroshi
# SPDX-License-Identifier: Apache-2.0

description: Renesas CPG/MSSR emulation

include: [clock-controller.yaml, base.yaml]

compatible: "renesas,rcar-cpg-mssr-emul"

properties:
  "#clock-cells":
    const: 2

clock-cells:
  - domain
  - module
```

## dts/bindings/display/raydium,rm68140.yaml
```yaml
description: Raydium RM68140 Panel

compatible: "raydium,rm68140"

include: [mipi-dbi-spi-device.yaml, display-controller.yaml]

properties:
  pixel-format:
    type: int
    default: 0
    enum:
      - 0 # RGB565
      - 1 # RGB888
    description:
      Display pixel format. Note that when RGB888 pixel format is selected
      only 6 color bits are actually used being in practice equivalent to
      RGB666.

  rotation:
    type: int
    default: 0
    enum:
      - 0
      - 90
      - 180
      - 270
    description:
      Display rotation (CW) in degrees.
      If not defined, rotation is off by default.

  display-inversion:
    type: boolean
    description:
      Display inversion mode. Every bit is inverted from the frame memory to
      the display.

# 電源、タイミング、ガンマ補正などの各レジスタ値を定義
  d0:
    type: uint8-array
    default: [0x07, 0x42, 0x18]
    description: "D0 command parameters for power/VCOM setting."
  d1:
    type: uint8-array
    default: [0x00, 0x07, 0x10]
    description: "D1 command parameters for additional power setting."
  d2:
    type: uint8-array
    default: [0x01, 0x02]
    description: "D2 command parameters for further power control."
  c0:
    type: uint8-array
    default: [0x10, 0x3B, 0x00, 0x02, 0x11]
    description: "C0 command parameters for panel drive timing."
  c5:
    type: uint8-array
    default: [0x03]
    description: "C5 command parameter for VCOM adjustment."
  c8:
    type: uint8-array
    default: [0x00, 0x32, 0x36, 0x45, 0x06, 0x16, 0x37, 0x75, 0x77, 0x54, 0x0C, 0x00]
    description: "C8 command parameters for gamma correction."
  madctl:
    type: uint8-array
    default: [0x0A]
    description: "Memory Access Control (MADCTL) register value."
  colmod:
    type: uint8-array
    default: [0x55]
    description: "Interface Pixel Format (COLMOD) register value."
  caset:
    type: uint8-array
    default: [0x00, 0x00, 0x01, 0x3F]
    description: "Column Address Set (CASET) register value."
  paset:
    type: uint8-array
    default: [0x00, 0x00, 0x01, 0xDF]
    description: "Page Address Set (PASET) register value."
```

## dts/bindings/gpio/gigadevice,gd32-gpio.yaml
```yaml
# Copyright (c) 2018, Linaro Limited
# SPDX-License-Identifier: Apache-2.0

title: GD32 GPIO

description: |
    This is a representation of the GD32 GPIO nodes

compatible: "gigadevice,gd32-gpio"

include: [gpio-controller.yaml, base.yaml]

properties:
    reg:
      required: true

    label:
      required: true

    clocks:
      required: true

    "#gpio-cells":
      const: 2

gpio-cells:
  - pin
  - flags
```

## dts/bindings/gpio/raspberrypi,pico-gpio.yaml
```yaml
# Copyright (c) 2021, Yonatan Schachter
# SPDX-License-Identifier: Apache-2.0

description: Raspberry Pi Pico GPIO

compatible: "raspberrypi,pico-gpio"

include: [gpio-nexus.yaml, base.yaml]
```

## dts/bindings/gpio/renesas,ra-gpio.yaml
```yaml
#
# Copyright (c) 2023 TOKITA Hiroshi <tokita.hiroshi@fujitsu.com>
#
# SPDX-License-Identifier: Apache-2.0
#

description: Renesas RA GPIO

compatible: "renesas,ra-gpio"

include: [gpio-controller.yaml, base.yaml]

properties:
  reg:
    required: true

  portno:
    type: int

  "#gpio-cells":
    const: 2

gpio-cells:
  - pin
  - flags
```

## dts/bindings/gpio/renesas,ra8-gpio.yaml
```yaml
# Copyright (c) 2024 Renesas Electronics Corporation
# SPDX-License-Identifier: Apache-2.0

description: Renesas RA8 GPIO

compatible: "renesas,ra8-gpio"

include: [gpio-controller.yaml, base.yaml]

properties:
  reg:
    required: true

  port:
    type: int
    required: true

  vbatts_pins:
    type: array
    description: Array of vbatt pin on port

  ext-irq0-pins:
    type: array
    description: Pins allow to assign ext-irq0

  ext-irq1-pins:
    type: array
    description: Pins allow to assign ext-irq1

  ext-irq2-pins:
    type: array
    description: Pins allow to assign ext-irq2

  ext-irq3-pins:
    type: array
    description: Pins allow to assign ext-irq3

  ext-irq4-pins:
    type: array
    description: Pins allow to assign ext-irq4

  ext-irq5-pins:
    type: array
    description: Pins allow to assign ext-irq5

  ext-irq6-pins:
    type: array
    description: Pins allow to assign ext-irq6

  ext-irq7-pins:
    type: array
    description: Pins allow to assign ext-irq7

  ext-irq8-pins:
    type: array
    description: Pins allow to assign ext-irq8

  ext-irq9-pins:
    type: array
    description: Pins allow to assign ext-irq9

  ext-irq10-pins:
    type: array
    description: Pins allow to assign ext-irq10

  ext-irq11-pins:
    type: array
    description: Pins allow to assign ext-irq11

  ext-irq12-pins:
    type: array
    description: Pins allow to assign ext-irq12

  ext-irq13-pins:
    type: array
    description: Pins allow to assign ext-irq13

  ext-irq14-pins:
    type: array
    description: Pins allow to assign ext-irq14

  ext-irq15-pins:
    type: array
    description: Pins allow to assign ext-irq15

  num-ext-irqs:
    type: int
    required: true
    description: Number of ext-irqs.

  "#gpio-cells":
    const: 2

gpio-cells:
  - pin
  - flags
```
