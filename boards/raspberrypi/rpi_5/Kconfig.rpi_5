## boards/raspberrypi/rpi_5/Kconfig.rpi_5
```kconfig
# Copyright 2024 Junho Lee <junho@tsnlab.com>
# SPDX-License-Identifier: Apache-2.0

config BOARD_RPI_5
	select SOC_BCM2712

config MAX_XLAT_TABLES
        default 16
```

## boards/sipeed/sipeed_longan_nano/board.yml
```yaml
board:
  name: sipeed_longan_nano
  full_name: Sipeed Longan Nano (minimal)
  vendor: sipeed
  socs:
    - name: gd32vf103
```

## boards/sipeed/tang_mega_138k_pro/Kconfig.defconfig
```kconfig
# Copyright The Zephyr Project Contributors
# SPDX-License-Identifier: Apache-2.0

if BOARD_TANG_MEGA_138K_PRO_AE350_DEMO

config SYS_CLOCK_HW_CYCLES_PER_SEC
	default 50000000

endif # BOARD_TANG_MEGA_138K_PRO_AE350_DEMO
```

## boards/sipeed/tang_mega_138k_pro/Kconfig.tang_mega_138k_pro
```kconfig
# Copyright The Zephyr Project Contributors
# SPDX-License-Identifier: Apache-2.0

config BOARD_TANG_MEGA_138K_PRO
	select SOC_AE350
```

## drivers/interrupt_controller/Kconfig.bcm2712_mip
```kconfig
# Copyright (c) 2026 TOKITA Hiroshi
# SPDX-License-Identifier: Apache-2.0

config INTC_BCM2712_MIP
	bool "Broadcom BCM2712 MSI-X Interrupt Peripheral (MIP)"
	default y
	depends on DT_HAS_BRCM_BCM2712_MIP_ENABLED
	help
	  Enable support for the BCM2712 MSI-X Interrupt Peripheral, which
	  converts inbound PCIe MSI/MSI-X writes into GIC SPI interrupts.
```

## drivers/pcie/Kconfig
```kconfig
# PCIe RC/EP drivers configuration options

source "drivers/pcie/host/Kconfig"
source "drivers/pcie/endpoint/Kconfig"
source "drivers/pcie/controller/Kconfig"
source "drivers/pcie/epf/Kconfig"
```

## drivers/pcie/endpoint/Kconfig.rockchip
```kconfig
# Copyright 2026
# SPDX-License-Identifier: Apache-2.0

config PCIE_EP_ROCKCHIP_RK3568
	bool "Rockchip RK3568 PCIe endpoint controller"
	default y
	depends on DT_HAS_ROCKCHIP_RK3568_PCIE_EP_ENABLED
	help
	  Enable the endpoint driver for the dual-mode PCIe 3.0 x2
	  controller in the Rockchip RK3568.

	  The clocks, reset and PCIe PHY must be initialized before this
	  driver runs. The driver configures the controller for endpoint
	  mode, starts link training, manages outbound iATU windows and
	  generates legacy, MSI and MSI-X interrupts.
```

## drivers/pcie/epf/Kconfig
```kconfig
# Copyright (c) 2026 TOKITA Hiroshi
# SPDX-License-Identifier: Apache-2.0

config PCI_EPF
	bool "PCI Endpoint Function framework"
	help
	  Enable the PCI Endpoint Function (EPF) framework. The framework
	  splits endpoint support into endpoint controller (EPC) drivers,
	  which program the endpoint hardware, and endpoint function (EPF)
	  drivers, which implement the behavior of a PCI function (its
	  configuration header, BARs and interrupts). The design follows
	  the Linux/NuttX PCI endpoint framework.

if PCI_EPF

module = PCI_EPF
module-str = pci_epf
source "subsys/logging/Kconfig.template.log_config"

endif # PCI_EPF
```

## drivers/pinctrl/renesas/rcar/Kconfig
```kconfig
# Copyright (c) 2021 IoT.bzh
# SPDX-License-Identifier: Apache-2.0

config PINCTRL_RCAR_PFC
	bool "Pin controller driver for Renesas RCar SoC"
	default y
	depends on DT_HAS_RENESAS_RCAR_PFC_ENABLED
	help
	  Enable pin controller driver for Renesas RCar SoC

config PINCTRL_RCAR_VOLTAGE_CONTROL
	bool "Voltage control functionality of Renesas R-Car PFC driver"
	default y if SOC_SERIES_RCAR_GEN3
	default y if SOC_R8A779G0_R52 || SOC_R8A779G0_A76
	depends on PINCTRL_RCAR_PFC
```

## drivers/tee/optee/Kconfig
```kconfig
# Copyright (c) 2023 EPAM Systems
# SPDX-License-Identifier: Apache-2.0

config OPTEE
	bool "OP-TEE driver"
	depends on (ARM64 && ARMV8_A_NS && HAS_ARM_SMCCC) || ZTEST
	help
	  This implements support of the OP-TEE firmware which is loaded
	  as BL32 image. OP-TEE is a Trust Zone OS which implements mechanisms
	  of the hardware isolation and rely to ARM TrustZone technology.
	  Driver requests functions from the OP-TEE and implements RPC mechanism
	  needed by OP-TEE to run services. See https://www.op-tee.org for more
	  information.

config OPTEE_MAX_NOTIF
	int "Max number of OP-TEE notifications"
	depends on OPTEE
	default $(UINT8_MAX)
	help
	 Sets the maximum notifications from OP-TEE to the Normal World. OP-TEE using
	 this mechanism for the synchronization.

config OPTEE_SHM_CACHE_MAX_ENTRIES
	int "Upper limit of SHM cache entries"
	depends on OPTEE
	default 16
	help
	  This sets the maximum number of entries in the SHM cache. SHM allocator
	  would not allocate more than this number of entries. This effectively
	  limits the number of OPTEE requests that can be in flight at any given
	  time. This is needed to prevent the possibility of causing a memory
	  leak by doing a large number of requests in parallel. The default value
	  of 16 should be sufficient for most use cases.
```

## drivers/vhost/Kconfig
```kconfig
# SPDX-FileCopyrightText: Copyright (c) 2025 TOKITA Hiroshi
# SPDX-License-Identifier: Apache-2.0

menuconfig VHOST
	bool "Support for VHOST"
	help
	  Enable options for VHOST

if VHOST

config VHOST_XEN_MMIO
	bool "support for MMIO-based VIRTIO backend on Xen hypervisor"
	default y
	depends on DT_HAS_XEN_VHOST_MMIO_ENABLED
	select XEN_STORE_CLI
	select XEN_DMOP
	help
	  Enable VIRTIO-MMIO backend on Xen hypervisor

module = VHOST
module-str = VHOST
source "subsys/logging/Kconfig.template.log_config"

endif # VHOST
```

## drivers/virtio/Kconfig
```kconfig
# Copyright (c) 2024 Antmicro <www.antmicro.com>
# SPDX-License-Identifier: Apache-2.0

config VIRTIO
	bool "support for VIRTIO"
	help
	  Enable options for VIRTIO

if VIRTIO

module = VIRTIO
module-str = VIRTIO
source "subsys/logging/Kconfig.template.log_config"

config VIRTIO_PCI
	bool "support for VIRTIO over PCI"
	default y
	depends on DT_HAS_VIRTIO_PCI_ENABLED
	select PCIE
	help
	  Enable options for VIRTIO over PCI

config VIRTIO_MMIO
	bool "support for VIRTIO over MMIO"
	default y
	depends on DT_HAS_VIRTIO_MMIO_ENABLED
	help
	  Enable options for VIRTIO over MMIO

config HEAP_MEM_POOL_ADD_SIZE_VIRTIO
	int "Heap memory pool size for VIRTIO"
	default 32768
	help
	  Set the size of the heap memory pool for VIRTIO.

config VIRTIO_ZENOH
	bool "VIRTIO Zenoh device driver"
	default y
	depends on DT_HAS_VIRTIO_DEVICE32769_ENABLED
	help
	  Driver for the experimental virtio-zenoh device (device ID 32769).
	  Provides a frame-oriented inter-VM IPC channel intended to carry
	  Zenoh transport messages.

if VIRTIO_ZENOH

config VIRTIO_ZENOH_BUF_SIZE
	int "Frame buffer size in bytes"
	default 2048
	help
	  Size of each receive and transmit frame buffer. Bounds the
	  effective MTU of the link.

config VIRTIO_ZENOH_RX_BUF_COUNT
	int "Number of receive buffers"
	default 4
	help
	  Number of receive buffers kept posted on the rx virtqueue.

config VIRTIO_ZENOH_TX_BUF_COUNT
	int "Number of transmit buffers"
	default 4
	help
	  Number of transmit buffers. Bounds the number of frames that can
	  be in flight on the tx virtqueue.

config VIRTIO_ZENOH_QUEUE_SIZE
	int "Requested virtqueue size"
	default 8
	help
	  Requested size for the rx and tx virtqueues. Must be a power of
	  two; the actual size is limited by the device maximum.

config VIRTIO_ZENOH_INIT_PRIORITY
	int "Init priority"
	default 60
	help
	  Device driver initialization priority. Must be greater than the
	  initialization priority of the underlying VIRTIO transport.

endif # VIRTIO_ZENOH

endif # VIRTIO
```

## dts/bindings/can/renesas,rcar-canfd.yaml
```yaml
description: Renesas R-Car Gen4 RS-CANFD controller (V4H)

compatible: "renesas,rcar-canfd"

include: [can-fd-controller.yaml, pinctrl-device.yaml]

properties:
  reg:
    required: true
  interrupts:
    required: false
  clocks:
    required: false
  resets:
    type: phandle-array
    required: false
    description: |
      Reset line for the CANFD controller (CPG module reset).

  reset-names:
    type: string-array
    required: false
    description: |
      Names of reset lines.
```

## dts/bindings/clock/zephyr,clock-controller-emul-common.yaml
```yaml
# SPDX-FileCopyrightText: Copyright (c) 2026 TOKITA Hiroshi
# SPDX-License-Identifier: Apache-2.0

description: Clock controller emulation

include: [clock-controller.yaml, base.yaml]

properties:
  clock-ids:
    type: array
    description: |
      Clock identifiers supported by the controller. Each identifier consists
      of #clock-cells values, laid out in the same order as the clock-cells
      of a clocks phandle-array entry. How those cells reach the driver as a
      clock_control_subsys_t is described by each compatible.

  clock-initial-values:
    type: array
    description: Initial rate in Hz for each identifier in clock-ids.

  strict:
    type: boolean
    description: |
      A flag indicate to checks the validity of the operation—such as the presence
      or absence of a clock ID—and returns an error response.
```

## dts/bindings/clock/zephyr,clock-controller-emul-rcar-cpg-mssr.yaml
```yaml
# Copyright (c) 2025 TOKITA Hiroshi
# SPDX-License-Identifier: Apache-2.0

description: Renesas CPG/MSSR emulation

include: ["zephyr,clock-controller-emul-common.yaml"]

compatible: "zephyr,clock-controller-emul-rcar-cpg-mssr"

properties:
  "#clock-cells":
    const: 2

clock-cells:
  - domain
  - module
```

## dts/bindings/clock/zephyr,clock-controller-emul.yaml
```yaml
# Copyright (c) 2025 TOKITA Hiroshi
# SPDX-License-Identifier: Apache-2.0

description: Clock controller emulation

include: ["zephyr,clock-controller-emul-common.yaml"]

compatible: "zephyr,clock-controller-emul"

properties:
  "#clock-cells":
    const: 1

clock-cells:
  - clk-id
```

## dts/bindings/gpio/raspberrypi,rp1-gpio.yaml
```yaml
# Copyright (c) 2024 Junho Lee <junho@tsnlab.com>
# SPDX-License-Identifier: Apache-2.0

description: GPIO Banks on RP1 peripheral controller

compatible: "raspberrypi,rp1-gpio"

include: [gpio-controller.yaml, base.yaml]

properties:
  reg:
    required: true
    description: |
      GPIO bank index. The bank's register spaces are provided by the parent
      raspberrypi,rp1-pinctrl node as gpioN, rioN, and padsN named regions.

  "#gpio-cells":
    const: 2

gpio-cells:
  - pin
  - flags
```

## dts/bindings/interrupt-controller/brcm,bcm2712-mip.yaml
```yaml
# Copyright (c) 2026 TOKITA Hiroshi
# SPDX-License-Identifier: Apache-2.0

description: |
  Broadcom BCM2712 MSI-X Interrupt Peripheral (MIP).

  The MIP converts inbound PCIe MSI/MSI-X memory writes into GIC SPI
  interrupts. An MSI write of data value N to the MIP target address
  raises the GIC SPI number (brcm,msi-base-spi + N).

  The first reg entry is the MIP control register block in the SoC
  address space. The second reg entry is the PCIe-bus-visible address
  that PCIe endpoints must target with their MSI/MSI-X messages; the
  PCIe root complex must map this bus address onto the MIP control
  block with an inbound window.

compatible: "brcm,bcm2712-mip"

include: base.yaml

properties:
  reg:
    required: true

  msi-controller:
    type: boolean
    description: Identifies the node as an MSI controller.

  brcm,msi-base-spi:
    type: int
    required: true
    description: First GIC SPI number that the MIP raises.

  brcm,msi-num-spis:
    type: int
    description: Number of GIC SPIs allocated to this MIP.
```

## dts/bindings/pcie/endpoint/rockchip,rk3568-pcie-ep.yaml
```yaml
# Copyright 2026
# SPDX-License-Identifier: Apache-2.0

description: |
  Rockchip RK3568 dual-mode PCIe 3.0 x2 controller in endpoint mode.

  The register ranges include the controller, CRU and PCIe 3.0 x2 PHY
  resources needed by the endpoint initialization sequence.

  Hot-reset handling temporarily idles BIU_PIPE. This interconnect is
  shared with other PD_PIPE clients, including USB 3, SATA, and XPCS.
  A system using those clients concurrently must coordinate BIU_PIPE
  ownership outside this driver.

  The published RK3568 TRMs do not expose software-visible PERST# or
  Function Level Reset events. The driver therefore supports reset
  notification for in-band hot reset only and does not advertise FLR.

compatible: "rockchip,rk3568-pcie-ep"

include: base.yaml

properties:
  reg:
    required: true

  reg-names:
    required: true
    description: |
      Must contain "dbi", "client", "map", "cru", "pmu_grf",
      "sys_grf", "pipe_grf", "phy_grf", and "pmu". The PMU range
      provides the BIU_PIPE idle handshake required before hot reset.

  rockchip,configure-m0-pins:
    type: boolean
    description: |
      Configure GPIO0_A6, GPIO0_C5, and GPIO0_C6 for the PCIe3x2 M0
      CLKREQ#, WAKE#, and PERST# functions.

  rockchip,external-refclk:
    type: boolean
    description: Use the 100 MHz differential reference clock input from the host

  num-ob-windows:
    type: int
    default: 1
    description: |
      Number of outbound iATU regions used to divide the outbound memory
      aperture. Valid values are powers of two from 1 through 16.

  vendor-id:
    type: int
    description: PCI vendor ID programmed before link training

  device-id:
    type: int
    description: PCI device ID programmed before link training

  class-revision:
    type: int
    description: Combined PCI class code and revision ID register value

  subsystem-vendor-id:
    type: int
    description: PCI subsystem vendor ID programmed before link training

  subsystem-id:
    type: int
    description: PCI subsystem ID programmed before link training
```
