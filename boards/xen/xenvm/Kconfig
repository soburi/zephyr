## boards/xen/xenvm/Kconfig
```kconfig
# Copyright (c) 2025 TOKITA Hiroshi
# SPDX-License-Identifier: Apache-2.0

config NUM_IRQS
	int "Max number of IRQs"
        default 100
```

## boards/xen/xenvm/Kconfig.xenvm
```kconfig
# Copyright (c) 2020 EPAM Systems
# SPDX-License-Identifier: Apache-2.0

config BOARD_XENVM
        select SOC_XENVM if !BOARD_XENVM_XENVM_R52 && !BOARD_XENVM_XENVM_R52_GICV3
        select SOC_XENVM_R52 if BOARD_XENVM_XENVM_R52 || BOARD_XENVM_XENVM_R52_GICV3
```

## boards/xen/xenvm/board.yml
```yaml
board:
  name: xenvm
  full_name: ARMv8 Xen Virtual Machine Example
  vendor: xen
  socs:
  - name: xenvm
    variants:
    - name: gicv3
  - name: xenvm_r52
    variants:
    - name: gicv3
```

## boards/xen/xenvm/xenvm_xenvm_r52_defconfig
```kconfig
# Enable MPU
CONFIG_ARM_MPU=y

# Enable UART driver
CONFIG_SERIAL=y

# Enable console
CONFIG_CONSOLE=y
CONFIG_UART_CONSOLE=y

# Enable logging subsys
CONFIG_LOG=y
CONFIG_LOG_MODE_MINIMAL=n

# Timer configuration
CONFIG_ARM_ARCH_TIMER=y
CONFIG_TIMER_READS_ITS_FREQUENCY_AT_RUNTIME=y

# Cache helpers
CONFIG_CACHE_MANAGEMENT=y
```

## drivers/adc/Kconfig.rpi_pico
```kconfig
# Copyright (c) 2022 TOKITA Hiroshi <tokita.hiroshi@fujitsu.com>
# SPDX-License-Identifier: Apache-2.0

# Workaround for not being able to have commas in macro arguments
DT_COMPAT_RPI_PICO_ADC := raspberrypi,pico-adc

config ADC_RPI_PICO
	default $(dt_compat_enabled,$(DT_COMPAT_RPI_PICO_ADC))
	bool "Raspberry Pi Pico ADC driver"
	select PICOSDK_USE_ADC
	depends on RESET
```

## drivers/audio/Kconfig.aw88298
```kconfig
# Copyright (c) 2025 The Zephyr Authors
#
# SPDX-License-Identifier: Apache-2.0

config AUDIO_CODEC_AW88298
bool "Awinic AW88298 smart amplifier"
depends on I2C
select AUDIO_CODEC
help
  Enable support for the Awinic AW88298 I2S smart power amplifier.
```

## drivers/audio/Kconfig.dmic_es7210
```kconfig
# SPDX-License-Identifier: Apache-2.0

config AUDIO_DMIC_ES7210
bool "Everest Semiconductor ES7210 digital microphone"
depends on I2C
depends on I2S
depends on DT_HAS_EVEREST_ES7210_DMIC_ENABLED
help
  Enable support for the Everest Semiconductor ES7210 audio ADC as a
  digital microphone source. The driver configures the converter over
  I2C and streams audio over an I2S interface.

config ES7210_DMIC_I2S_TIMEOUT_MS
int "I2S read timeout (ms)"
depends on AUDIO_DMIC_ES7210
default 2000
help
  Timeout, in milliseconds, used for I2S read operations performed
  by the ES7210 digital microphone driver.
```

## drivers/audio/Kconfig.es7210
```kconfig
# Copyright (c) 2025
# SPDX-License-Identifier: Apache-2.0

config AUDIO_CODEC_ES7210
	bool "Everest ES7210 codec support"
	default y
	select I2C
	depends on DT_HAS_EVEREST_ES7210_ENABLED
	help
	  Enable support for the Everest ES7210 audio ADC.
```

## drivers/clock_control/Kconfig.gd32
```kconfig
# Copyright (c) 2019 Linaro
# SPDX-License-Identifier: Apache-2.0
#
menuconfig CLOCK_CONTROL_GD32
	bool "GD32 Clock Control"
	depends on SOC_SERIES_RISCV_GIGADEVICE_GD32VF103
	default y if SOC_SERIES_RISCV_GIGADEVICE_GD32VF103
	help
	  Enable driver for Reset & Clock Uint found
	  in GD32 family of MCUs
```

## drivers/clock_control/Kconfig.qingke
```kconfig
# Copyright (c) 2023 Chen Xingyu <hi@xingrz.me>
# SPDX-License-Identifier: Apache-2.0

config CLOCK_CONTROL_CH56X
	bool "WCH CH56x HCLK clock controller"
	default y
	depends on DT_HAS_WCH_CH56X_HCLK_ENABLED
	select SYSCON
	help
	  Enable WCH CH56x HCLK clock controller.
```

## drivers/clock_control/Kconfig.ra
```kconfig
# Copyright (c) 2023 TOKITA Hiroshi <tokita.hiroshi@fujitsu.com>
# SPDX-License-Identifier: Apache-2.0

config CLOCK_CONTROL_RA
	bool "Renesas RA Clock controller"
	default y
	depends on DT_HAS_RENESAS_RA_CLOCK_ENABLED
	help
	  Enable support for Renesas RA Clock Controllerdriver.
```

## drivers/clock_control/Kconfig.rcar
```kconfig
# Copyright (c) 2021-2023 IoT.bzh
# SPDX-License-Identifier: Apache-2.0

config CLOCK_CONTROL_RCAR_CPG_MSSR
	bool "RCar CPG MSSR driver"
	default y
	depends on SOC_FAMILY_RENESAS_RCAR
	help
	  Enable support for Renesas RCar CPG MSSR driver.

config CLOCK_CONTROL_RCAR_CPG_MSSR_EMUL
	bool "RCar CPG MSSR emulator driver"
	default y
	depends on DT_HAS_RENESAS_RCAR_CPG_MSSR_EMUL_ENABLED
	help
	  Enable support for Renesas RCar CPG MSSR driver.
```

## drivers/display/Kconfig.led_panel
```kconfig
# Copyright (c) 2023 TOKITA Hiroshi
# SPDX-License-Identifier: Apache-2.0

config LED_PANEL
	bool "LED panel display driver"
	default y
	depends on DT_HAS_LED_PANEL_ENABLED
	help
	  Enable dummy display driver compliant with display driver API.
```

## drivers/display/Kconfig.rm68140
```kconfig
# Copyright 2025, TOKITA Hiroshi
# SPDX-License-Identifier: Apache-2.0

config RM68140
        bool "RM68140 display driver"
        default y
	depends on MIPI_DBI
        depends on DT_HAS_RAYDIUM_RM68140_ENABLED
        help
          Enable driver for RM68140 display driver.
```

## drivers/display/Kconfig.st7735s
```kconfig
# ST7735S display driver configuration options

# Copyright (c) 2019 Marc Reilly <marc@cpdesign.com.au>
# SPDX-License-Identifier: Apache-2.0

menuconfig ST7735S
	bool "ST7735S display driver"
	depends on SPI
	help
	  Enable driver for ST7735S display driver.

if ST7735S

choice
	prompt "LCD"
	help
	  Specify the type of LCD connected to the ST7735S display controller.

config ST7735S_LCD_SIPEED_160x80_IPS
	bool "Sipeed 160x80 IPS LCD"

endchoice

choice
	prompt "Color pixel format"
	default ST7735S_RGB565
	help
	  Specify the color pixel format for the ST7735S display controller.

config ST7735S_RGB888
	bool "RGB888"

config ST7735S_RGB565
	bool "RGB565"

endchoice

if ST7735S_RGB565
config ST7735S_SWAP_PIXEL_LCD_ENDIANNESS
	bool "Swap pixel endianness at LCD"
	help
	  Pixel data bytes are swapped when being blitted to the LCD.
	  Note that this isn't just a swap of RGB <--> BGR, (if the endianness is
	  swapped then the 3 lowest bits of G are sent first/last).
	  You may want to enable this if you are using lvgl and your colors
	  don't look right.

config ST7735S_REVERSE_LCD_RGB_ORDER
	bool "Reverse draw order of controller ram to LCD"
	help
	  This reverses the order that the controller draws RGB to the LCD.

config ST7735S_REVERSE_X
	bool "Reverse X axis"
	help
	  Address pixels from right to left.

config ST7735S_REVERSE_Y
	bool "Reverse Y axis"
	help
	  Address pixels from bottom to top.

endif # ST7735S_RGB565

endif # ST7735S
```

## drivers/gpio/Kconfig.aw9523b
```kconfig
# Copyright (c) 2024 TOKITA Hiroshi
# SPDX-License-Identifier: Apache-2.0

config GPIO_AW9523B
	bool "AW9523B GPIO driver"
	default y
	depends on DT_HAS_AWINIC_AW9523B_GPIO_ENABLED
	select I2C
	select MFD
	help
	  Enable the AW9523B GPIO controller.

config GPIO_AW9523B_DUMP_REGS
	bool "Dump AW9523B register state during init"
	depends on GPIO_AW9523B
	help
	  If enabled, the driver prints the initial INPUT, OUTPUT, CONFIG and
	  control register values when the AW9523B is initialised. Useful for
	  bring-up and validation of external pin configuration.
```

## drivers/gpio/Kconfig.gd32
```kconfig
# GD32 GPIO configuration

# Copyright (c) 2016 Open-RnD Sp. z o.o.
# SPDX-License-Identifier: Apache-2.0

menuconfig GPIO_GD32
	bool "GPIO Driver for GD32 family of MCUs"
	depends on SOC_SERIES_RISCV_GIGADEVICE_GD32VF103
	select HAS_DTS_GPIO
	help
	  Enable GPIO driver for GD32 line of MCUs

if GPIO_GD32

config GPIO_GD32_PORTA
	bool "Enable GPIO port A support"

config GPIO_GD32_PORTB
	bool "Enable GPIO port B support"

config GPIO_GD32_PORTC
	bool "Enable GPIO port C support"

config GPIO_GD32_PORTD
	bool "Enable GPIO port D support"

config GPIO_GD32_PORTE
	bool "Enable GPIO port E support"

config GPIO_GD32_PORTF
	bool "Enable GPIO port F support"

config GPIO_GD32_PORTG
	bool "Enable GPIO port G support"

config GPIO_GD32_PORTH
	bool "Enable GPIO port H support"

config GPIO_GD32_PORTI
	bool "Enable GPIO port I support"

config GPIO_GD32_PORTJ
	bool "Enable GPIO port J support"

config GPIO_GD32_PORTK
	bool "Enable GPIO port K support"

if SOC_SERIES_GD32F1X

choice GPIO_GD32_SWJ
	prompt "Serial wire JTAG configuration"

config GPIO_GD32_SWJ_ENABLE
	depends on !(SOC_GD32F103XE && SPI_3)
	bool "Full SWJ (JTAG-DP + SW-DP): Reset State"

config GPIO_GD32_SWJ_NONJTRST
	depends on !(SOC_GD32F103XE && SPI_3)
	bool "Full SWJ (JTAG-DP + SW-DP) but without NJTRST"

config GPIO_GD32_SWJ_NOJTAG
	bool "JTAG-DP Disabled and SW-DP Enabled"

config GPIO_GD32_SWJ_DISABLE
	bool "JTAG-DP Disabled and SW-DP Disabled"

endchoice

endif # SOC_SERIES_GD32F1X

endif # GPIO_GD32
```

## drivers/gpio/Kconfig.ra
```kconfig
# Copyright (c) 2023 TOKITA Hiroshi <tokita.hiroshi@fujitsu.com>
# SPDX-License-Identifier: Apache-2.0

config GPIO_RA
	bool "Renesas RA Series GPIO driver"
	default y
	depends on DT_HAS_RENESAS_RA_GPIO_ENABLED
	help
	  Enable Renesas RA GPIO driver.
```

## drivers/gpio/Kconfig.rpi_pico
```kconfig
# Copyright (c) 2021 Yonatan Schachter
# SPDX-License-Identifier: Apache-2.0

config GPIO_RPI_PICO
	default y
	depends on DT_HAS_RASPBERRYPI_PICO_GPIO_ENABLED
	select PICOSDK_USE_GPIO
	select GPIO_64BIT_PORT if SOC_SEREIS_RP2350
	bool "Raspberry Pi Pico GPIO driver"
```

## drivers/hwspinlock/Kconfig.rpi_pico
```kconfig
# Sequans HW spinlock configuration

# Copyright (c) 2023 Sequans Communications.
# SPDX-License-Identifier: Apache-2.0

config RPI_PICO_HWSPINLOCK
	bool "RaspberryPi Pico HW spinlock Driver"
	default y
	depends on DT_HAS_RASPBERRYPI_PICO_HWSPINLOCK_ENABLED
	help
	  Enable HW spinlock for SQN
```

## drivers/i2s/Kconfig.test
```kconfig
# Copyright (c) 2021, Nordic Semiconductor ASA
# SPDX-License-Identifier: Apache-2.0

# Hidden option for turning on the dummy driver for vnd,spi devices
# used in testing.
config I2S_TEST
	def_bool DT_HAS_VND_I2S_ENABLED
	depends on DT_HAS_VND_I2S_ENABLED
```

## drivers/interrupt_controller/Kconfig.qingke
```kconfig
# Copyright (c) 2023 Chen Xingyu <hi@xingrz.me>
# SPDX-License-Identifier: Apache-2.0

config QINGKE_PFIC
	bool "WCH QingKe PFIC"
	default y
	depends on DT_HAS_WCH_QINGKE_PFIC_ENABLED
	depends on RISCV_HAS_CLIC
	help
	  Enable WCH QingKe PFIC driver.
```

## drivers/interrupt_controller/Kconfig.renesas_ra
```kconfig
# Copyright (c) 2023 TOKITA Hiroshi <tokita.hiroshi@fujitsu.com>
# SPDX-License-Identifier: Apache-2.0

config RENESAS_RA_ICU
	bool "Renesas RA series interrupt controller unit"
	default y
	depends on DT_HAS_RENESAS_RA_INTERRUPT_CONTROLLER_UNIT_ENABLED
	help
	  Renesas RA series interrupt controller unit

if RENESAS_RA_ICU

config RA_ICU_ISR_ASSIGN_OFFSET
	int "Specify the first interrupt used for dynamic assignment"
	default 0
	help
	  Interrupts after this number will be used for dynamic assignment.
	  When there are interrupts that need to be assigned fixedly,
	  This option is used to exclude these interrupts.

endif
```

## drivers/misc/pio_rpi_pico/Kconfig
```kconfig
# Copyright (c) 2023 Ionut Pavel <iocapa@iocapa.com>
# Copyright (c) 2023 TOKITA Hiroshi <tokita.hiroshi@fujitsu.com>
# SPDX-License-Identifier: Apache-2.0

config PIO_RPI_PICO
	bool "RaspberryPi Pico PIO"
	default y
	depends on DT_HAS_RASPBERRYPI_PICO_PIO_ENABLED
	depends on RESET
	select PICOSDK_USE_PIO

config PIO_INTR_DISPATCHER_RPI_PICO
	bool "RaspberryPi Pico PIO interrupt_dispatcher"
	default y
	depends on DT_HAS_RASPBERRYPI_PICO_PIO_INTR_DISPATCHER_ENABLED

if PIO_RPI_PICO

module = PIO_RPI_PICO
module-str = pio_rpi_pico
source "subsys/logging/Kconfig.template.log_config"

if PIO_INTR_DISPATCHER_RPI_PICO

config PIO_RPI_PICO_INSTR_COUNT
	int "Number of Program Instructions for each PIO"
	default 32 if SOC_RP2040

config PIO_RPI_PICO_SM_COUNT
	int "Number of State Machine instances for each PIO"
	default 4 if SOC_RP2040

endif

endif
```

## drivers/pinctrl/Kconfig.bcm2712
```kconfig
# Copyright (c) 2025 TOKITA Hiroshi
# SPDX-License-Identifier: Apache-2.0

config PINCTRL_BCM2712
        bool "Raspberry Pi RP1 pin controller driver"
        default y
        depends on DT_HAS_BRCM_BCM2712_PINCTRL_ENABLED
        help
          Enable pin controller driver for the Raspberry Pi RP1 peripheral.
```
