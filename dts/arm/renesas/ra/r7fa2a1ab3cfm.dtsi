/*
 * Copyright (c) 2023 TOKITA Hiroshi <tokita.hiroshi@fujitsu.com>
 *
 * SPDX-License-Identifier: Apache-2.0
 */

#define RA_SOC_PINS 64
#define RA_SOC_HAS_MSTPCRE 1
#define RA_SOC_MSTPD5_CHANNELS 1

#include <zephyr/dt-bindings/clock/r7fa2a1xxxxxx-clock.h>
#include <renesas/ra/ra2-cm23-common.dtsi>
