## dts/bindings/interrupt-controller/gigadevice,gd32vf103-eclic.yaml
```yaml
# Copyright (c) 2018, SiFive Inc.
# SPDX-License-Identifier: Apache-2.0

title: GigaDevice GD32VF103-ECLIC
description: GigaDevice GD32VF103 enhancled core-local interrupt controller

compatible: "gigadevice,gd32vf103-eclic"

include: [interrupt-controller.yaml, base.yaml]

properties:
  "#interrupt-cells":
      const: 2

interrupt-cells:
  - irq
  - priority

#properties:
#    riscv,ndev:
#        type: int
#        description: Number of external interrupts supported
#        required: true
```

## dts/bindings/interrupt-controller/wch,qingke-pfic.yaml
```yaml
# Copyright (c) 2023 Chen Xingyu <hi@xingrz.me>
# SPDX-License-Identifier: Apache-2.0

description: WCH QingKe PFIC

compatible: "wch,qingke-pfic"

include: [interrupt-controller.yaml, base.yaml]

properties:
  reg:
    required: true

  "#interrupt-cells":
    const: 2

interrupt-cells:
  - irq
  - priority
```

## dts/bindings/led/x-powers,axp2101-led.yaml
```yaml
# Copyright (c) 2023 Nordic Semiconductor ASA
# SPDX-License-Identifier: Apache-2.0

description: |
  Nordic nPM1300 LED controller

  The nPM1300 has three LED outputs.
  Each LED can automatically display error or charging status,
  or be controlled by software.

compatible: "x-powers,axp2101-led"

properties:
  x-powers,mode:
    type: string
    enum:
      - "type-a"
      - "type-b"
      - "by-reg"
```

## dts/bindings/led_strip/worldsemi,ws2812-rpi_pico-pio.yaml
```yaml
# Copyright (c) 2023, TOKITA Hiroshi
# SPDX-License-Identifier: Apache-2.0

description: |
  Worldsemi WS2812 or compatible LED strip driver based on RaspberryPi Pico's PIO
  The LED strip node can put up to 4 instances under a single PIO node.

compatible: "worldsemi,ws2812-rpi_pico-pio"

include: ws2812.yaml

properties:
  output-pin:
    type: int
    required: true
    description: |
      Select the output pin.

      Note: This driver does not configure the output pin.
      You need to configure the pin with pinctrl that is in the parent node configuration
      for use by PIO.

  frequency:
    type: int
    description: |
      Specify the number of times a waveform representing 1 bit is
      transmitted per second. It is same meaning as bit-per-seconds.
      WS2812 works with 800000. Set the value 400000 if use with WS2811.
```

## dts/bindings/misc/raspberrypi,pico-pio-intr-dispatcher.yaml
```yaml
# Copyright (c) 2023 Ionut Pavel <iocapa@iocapa.com>
# Copyright (c) 2023, TOKITA Hiroshi
# SPDX-License-Identifier: Apache-2.0

description: Raspberry Pi Pico PIO

compatible: "raspberrypi,pico-pio-intr-dispatcher"

include: [base.yaml, reset-device.yaml]

bus: pio-rpi-pico
```

## dts/bindings/pinctrl/brcm,bcm2712-pinctrl.yaml
```yaml
# Copyright (c) 2025 TOKITA Hiroshi
# SPDX-License-Identifier: Apache-2.0

title: Raspberry Pi RP1 Pin Controller

description: |
  RP1 I/O controller pinmux and pad configuration. The RP1 is the
  peripheral controller used on the Raspberry Pi 5. Each controller bank
  manages a group of GPIO pins and exposes the function selection and pad
  control registers for those pins.

compatible: "brcm,bcm2712-pinctrl"

include: base.yaml

child-binding:
  description: |
    Pin controller state node.
  child-binding:

    include:
      - name: pincfg-node.yaml
        property-allowlist:
          - bias-disable
          - bias-pull-down
          - bias-pull-up
          - input-enable
          - input-schmitt-enable
          - drive-strength
          - slew-rate

    properties:
      pinmux:
        required: true
        type: array
```

## dts/bindings/pinctrl/gigadevice,gd32-pinmux.yaml
```yaml
title: GD32 PINMUX

description: |
    This binding gives a base representation of the GD32 PINMUX

compatible: "gigadevice,gd32-pinmux"

include: base.yaml

properties:
    reg:
      required: true

pinmux-cells:
  - pin
  - function
```

## dts/bindings/pinctrl/renesas,ra-pinctrl.yaml
```yaml
# Copyright (c) 2023 TOKITA Hiroshi <tokita.hiroshi@fujitsu.com>
# SPDX-License-Identifier: Apache-2.0

description: |
    The RPi Pico pin controller is a node responsible for controlling

compatible: "renesas,ra-pinctrl"

include: base.yaml

child-binding:
  description: |
    Definitions for a pinctrl state.
  child-binding:

    include:
      - name: pincfg-node.yaml
        property-allowlist:
          - bias-disable
          - bias-pull-down
          - bias-pull-up
          - input-enable
          - input-schmitt-enable
          - drive-strength
          - slew-rate

    properties:
      pinmux:
        required: true
        type: array
        description: |
          An array of pins sharing the same group properties. Each
          element of the array is an integer constructed from the
          pin number and the alternative function of the pin.
```

## dts/bindings/regulator/x-powers,axp2101-regulator.yaml
```yaml
#  Copyright 2024 TOKITA Hiroshi
# SPDX-License-Identifier: Apache-2.0

description: |
  AXP2101 PMIC


compatible: "x-powers,axp2101-regulator"

on-bus: axp2101

include: base.yaml

child-binding:
  include:
    - name: regulator.yaml
      property-allowlist:
        - regulator-init-microvolt
        - regulator-min-microvolt
        - regulator-max-microvolt
        - regulator-always-on
        - regulator-boot-on
        - regulator-boot-off
        - regulator-initial-mode
        - regulator-allowed-modes

  properties:
    regulator-initial-mode:
      type: int
      default: 0
      enum:
        - 0
        - 1
      description: |
        Initial operating mode. AXP2101 supports 2 different power modes:
        AXP2101_DCDC_MODE_AUTO: Auto (0, default)
        AXP2101_DCDC_MODE_PWM:  PWM
```

## dts/bindings/sdhc/brcm,bcm2712-sdhci.yaml
```yaml
# Copyright (c) 2024 EPAM Systems
# SPDX-License-Identifier: Apache-2.0
description: Broadcom BCM2712 SDHC v3.0 (MMC)

compatible: "brcm,bcm2712-sdhci"

include: [sdhc.yaml]

properties:
  clocks:
    required: true

  reg:
    required: true

  cd-gpios:
    type: phandle-array
    description: Card Detect pin

  vmmc-supply:
    type: phandle
    description: |
      Supply for the card power

  vqmmc-supply:
    type: phandle
    description: |
      Supply for the bus IO line power, such as a level shifter.
      If the level shifter is controlled by a GPIO line, this shall
      be modeled as a "regulator-fixed" with a GPIO line for
      switching the level shifter on/off.

  bus-width:
    type: int
    default: 1
    description: |
        Bus width for SDMMC access, defaults to the minimum necessary
        number of bus lines
    enum:
      - 1
      - 4
      - 8

  non-removable:
    type: boolean
    description: |
      Non-removable slots (like eMMC), which are assumed to always be present.
```

## dts/bindings/sensor/liteon,ltr553.yaml
```yaml
# SPDX-License-Identifier: Apache-2.0

description: LiteOn LTR-553 ambient light and proximity sensor

compatible: "liteon,ltr553"

include: [sensor-device.yaml, i2c-device.yaml]
```

## dts/bindings/sensor/maxim,max30102.yaml
```yaml
# Copyright (c) 2018, NXP
# SPDX-License-Identifier: Apache-2.0

description: MAX30102 heart rate sensor

compatible: "maxim,max30102"

include: "maxim,max301xx-common.yaml"
```

## dts/bindings/sensor/maxim,max301xx-common.yaml
```yaml
# Copyright (c) 2025 TOKITA Hiroshi
# SPDX-License-Identifier: Apache-2.0

description: MAX301xx heart rate sensor common definition

include: [sensor-device.yaml, i2c-device.yaml]

properties:
  sample-averaging:
    type: int
    default: 1
    enum: [1, 2, 4, 8, 16, 32]
    description: |
      To reduce the amount of data throughput, adjacent samples (in each
      individual channel) can be averaged and decimated on the chip by
      setting this register. Set to 1 for no averaging.

  fifo-rollover:
    type: boolean
    description: |
      Controls the behavior of the FIFO when the FIFO becomes completely
      filled with data. If set, the FIFO address rolls over to zero and the
      FIFO continues to fill with new data. If not set, then the FIFO is
      not updated until FIFO_DATA is read or the WRITE/READ pointer
      positions are changed.

  fifo-almost-full:
    type: int
    default: 0
    enum: [0, 1, 2, 3, 4, 5, 6, 7, 8, 9, 10, 11, 12, 13, 14, 15]
    description: |
      Set the trigger for the FIFO_A_FULL interrupt

  mode:
    type: string
    enum:
      - "HEART_RATE"
      - "SPO2"
      - "MULTI_LED"

  adc-full-scale:
    type: int
    default: 2048
    enum: [2048, 4096, 8192, 16384]
    description: |
      Set the ADC's full-scale.
      2048  = 7.81 pA/LSB
      4096  = 15.63 pA/LSB
      8192  = 31.25 pA/LSB
      16384 = 62.5 pA/LSB

  sample-rate:
    type: int
    default: 50
    enum: [50, 100, 200, 400, 800, 1000, 1600, 3200]
    description:
      Set the effective sampling rate with one sample consisting of one
      pulse/conversion per active LED channel. In SpO2 mode, these means
      one IR pulse/conversion and one red pulse/conversion per sample period.

  adc-resolution:
    type: int
    default: 15
    enum: [15, 16, 17, 18]

  led-pulse-amplitude:
    type: array
    description: |
      Set the pulse amplitude to control the LED1 (red) current in micro-ampere.
      The actual measured LED current for each part can vary significantly due to
      the trimming methodology.

  multi-led-slot:
    type: string-array
    enum:
      - "NONE"
      - "LED1"
      - "LED2"
      - "LED3"
    description: |
      Set which LED and pulse amplitude are active in time slot 1.
```

## dts/bindings/serial/gigadevice,gd32-uart.yaml
```yaml
title: GD32 UART

description: |
    This binding gives a base representation of the GD32 UART

compatible: "gigadevice,gd32-uart"

include: uart-controller.yaml

properties:
    reg:
      required: true

    interrupts:
      required: true
```

## dts/bindings/serial/gigadevice,gd32-usart.yaml
```yaml
title: GD32 USART

description: |
    This binding gives a base representation of the GD32 USART

compatible: "gigadevice,gd32-usart"

include: uart-controller.yaml

properties:
    reg:
      required: true

    interrupts:
      required: true
```

## dts/bindings/serial/renesas,ra-uart-sci.yaml
```yaml
# Copyright (c) 2023 TOKITA Hiroshi <tokita.hiroshi@fujitsu.com>
# SPDX-License-Identifier: Apache-2.0
#
description: Renesas RA Series UART controller

compatible: "renesas,ra-uart-sci"

include: [uart-controller.yaml, pinctrl-device.yaml]

properties:
  channel:
    type: int
    required: true
```

## dts/bindings/spi/gigadevice,gd32-spi.yaml
```yaml
# Copyright (c) 2018, I-SENSE group of ICCS
# SPDX-License-Identifier: Apache-2.0

description: GD32 SPI controller

compatible: "gigadevice,gd32-spi"

include: spi-controller.yaml

properties:
    reg:
      required: true

    interrupts:
      required: true
```

## dts/bindings/timer/wch,qingke-v3-systick.yaml
```yaml
# Copyright (c) 2023 Chen Xingyu <hi@xingrz.me>
# SPDX-License-Identifier: Apache-2.0

description: WCH QingKe V3 SysTick

compatible: "wch,qingke-v3-systick"

include: base.yaml

properties:
  reg:
    required: true

  interrupts:
    required: true
```

## modules/hal_renesas/Kconfig
```kconfig
# Copyright (c) 2023 TOKITA Hiroshi <tokita.hiroshi@fujitsu.com>
# SPDX-License-Identifier: Apache-2.0

config ZEPHYR_HAL_RENESAS_MODULE
	bool

rsource "fsp/Kconfig"
```
