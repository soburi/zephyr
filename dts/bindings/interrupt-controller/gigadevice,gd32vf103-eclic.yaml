## modules/hal_renesas/fsp/Kconfig
```kconfig
# Copyright (c) 2023 TOKITA Hiroshi <tokita.hiroshi@fujitsu.com>
# SPDX-License-Identifier: Apache-2.0

config HAS_FSP
	bool

menu "Renesas FSP drivers"
	depends on HAS_FSP

config USE_FSP_ACMPHS
	bool
	help
	  Enable FSP High Speed Analog Comparator (ACMPHS) driver

config USE_FSP_ACMPLP
	bool
	help
	  Enable FSP Low Power Analog Comparator (ACMPLP) driver

config USE_FSP_ADC_B
	bool
	help
	  Enable FSP A/D Converter (ADC) driver

config USE_FSP_ADC
	bool
	help
	  Enable FSP A/D Converter (ADC) driver

config USE_FSP_AGT
	bool
	help
	  Enable FSP Asynchronous General-Purpose Timer (AGT) driver

config USE_FSP_CAC
	bool
	help
	  Enable FSP Clock Frequency Accuracy Measurement Circuit (CAC) driver

config USE_FSP_CANFD
	bool
	help
	  Enable FSP CAN-FD (CANFD) driver

config USE_FSP_CAN
	bool
	help
	  Enable FSP Controller Area Network (CAN) driver

config USE_FSP_CEC
	bool
	help
	  Enable FSP HDMI CEC (CEC) driver

config USE_FSP_CGC
	bool
	help
	  Enable FSP Clock Generation Circuit (CGC) driver

config USE_FSP_CRC
	bool
	help
	  Enable FSP Cyclic Redundancy Check Calculator (CRC) driver

config USE_FSP_CTSU
	bool
	help
	  Enable FSP Capacitive Touch Sensing Unit (CTSU) driver

config USE_FSP_DAC8
	bool
	help
	  Enable FSP 8-Bit D/A Converter (DAC8) driver

config USE_FSP_DAC
	bool
	help
	  Enable FSP 12-Bit D/A Converter (DAC) driver

config USE_FSP_DMAC
	bool
	help
	  Enable FSP DMA Controller (DMAC) driver

config USE_FSP_DOC
	bool
	help
	  Enable FSP Data Operation Circuit (DOC) driver

config USE_FSP_DTC
	bool
	help
	  Enable FSP Data Transfer Controller (DTC) driver

config USE_FSP_ELC
	bool
	help
	  Enable FSP Event Link Controller (ELC) driver

config USE_FSP_ETHER
	bool
	help
	  Enable FSP Ethernet MAC Controller (ETHER) driver

config USE_FSP_ETHER_PHY
	bool
	help
	  Enable FSP Ethernet Phy (ETHER_PHY) driver

config USE_FSP_FLASH_HP
	bool
	help
	  Enable FSP High-Performance Flash (FLASH_HP) driver

config USE_FSP_FLASH_LP
	bool
	help
	  Enable FSP Low-Power Flash (FLASH_LP) driver

config USE_FSP_GLCDC
	bool
	help
	  Enable FSP Graphics LCD Controller (GLCDC) driver

config USE_FSP_GPT
	bool
	help
	  Enable FSP General PWM Timer (GPT) driver

config USE_FSP_GPT_THREE_PHASE
	bool
	help
	  Enable FSP 3-Phase General PWM Timer (GPT) driver

config USE_FSP_I3C
	bool
	help
	  Enable FSP I3C driver

config USE_FSP_ICU
	bool
	help
	  Enable FSP Interrupt Control Unit (ICU) driver

config USE_FSP_IIC_B_MASTER
	bool
	help
	  Enable FSP I2C Bus Interface B (IIC_B) master driver

config USE_FSP_IIC_B_SLAVE
	bool
	help
	  Enable FSP I2C Bus Interface B (IIC_B) slave driver

config USE_FSP_IIC_MASTER
	bool
	help
	  Enable FSP I2C Bus Interface (IIC) master driver

config USE_FSP_IIC_SLAVE
	bool
	help
	  Enable FSP I2C Bus Interface (IIC) slave driver

config USE_FSP_IIRFA
	bool
	help
	  Enable FSP IIR Filter Accelerator (IIRFA) driver

config USE_FSP_IOPORT
	bool
	help
	  Enable FSP I/O Ports (IOPORT) driver

config USE_FSP_IWDT
	bool
	help
	  Enable FSP Independent Watch Dog Timer (IWDT) driver

config USE_FSP_JPEG
	bool
	help
	  Enable FSP JPEG (JPEG) driver

config USE_FSP_KINT
	bool
	help
	  Enable FSP Key Interrupt Function (KINT) driver

config USE_FSP_LPM
	bool
	help
	  Enable FSP Low Power Modes (LPM) driver

config USE_FSP_LVD
	bool
	help
	  Enable FSP Low Voltage Detection (LVD) driver

config USE_FSP_OPAMP
	bool
	help
	  Enable FSP Operational Amplifier (OPAMP) driver

config USE_FSP_OSPI
	bool
	help
	  Enable FSP Octa Serial Peripheral Interface (OSPI) driver

config USE_FSP_PDC
	bool
	help
	  Enable FSP Parallel Data Capture Unit (PDC) driver

config USE_FSP_POEG
	bool
	help
	  Enable FSP Port Output Enable for GPT (POEG) driver

config USE_FSP_PTP
	bool
	help
	  Enable FSP Ethernet PTP Controller (EPTPC) driver

config USE_FSP_QSPI
	bool
	help
	  Enable FSP Quad Serial Peripheral Interface (QSPI) driver

config USE_FSP_RTC
	bool
	help
	  Enable FSP Real Time Clock (RTC) driver

config USE_FSP_SCE_KEY_INJECTION
	bool
	help
	  Enable FSP Secure Cryptographic Engine (SCE) key injection driver

config USE_FSP_SCI_B_I2C
	bool
	help
	  Enable FSP Serial Communications Interface B (SCI_B) driver

config USE_FSP_SCI_B_SPI
	bool
	help
	  Enable FSP Serial Communications Interface B (SCI_B) driver

config USE_FSP_SCI_B_UART
	bool
	help
	  Enable FSP Serial Communications Interface B (SCI_B) driver

config USE_FSP_SCI_I2C
	bool
	help
	  Enable FSP Serial Communications Interface (SCI) driver

config USE_FSP_SCI_SPI
	bool
	help
	  Enable FSP Serial Communications Interface (SCI) driver

config USE_FSP_SCI_UART
	bool
	help
	  Enable FSP Serial Communications Interface (SCI) driver

config USE_FSP_SDADC
	bool
	help
	  Enable FSP Sigma Delta A/D Converter (SDADC) driver

config USE_FSP_SDHI
	bool
	help
	  Enable FSP SD/MMC Host Interface (SDHI) driver

config USE_FSP_SLCDC
	bool
	help
	  Enable FSP Segment LCD Controller (SLCDC) driver

config USE_FSP_SPI_B
	bool
	help
	  Enable FSP Serial Peripheral Interface B (SPI_B) driver

config USE_FSP_SPI
	bool
	help
	  Enable FSP Serial Peripheral Interface (SPI) driver

config USE_FSP_SSI
	bool
	help
	  Enable FSP Serial Sound Interface (SSI) driver

config USE_FSP_ULPT
	bool
	help
	  Enable FSP Ultra Low Power Timer ULPT (ULPT) driver

config USE_FSP_USB_BASIC
	bool
	help
	  Enable FSP USB (USB) basic driver

config USE_FSP_USB_HHID
	bool
	help
	  Enable FSP USB Host Human Interface Device (USB_HHID) driver

config USE_FSP_USB_HMSC
	bool
	help
	  Enable FSP USB Host Mass Storage Class (USB_HMSC) driver

config USE_FSP_WDT
	bool
	help
	  Enable FSP Watch Dog Timer (WDT) driver

endmenu
```

## samples/modules/wasm_micro_runtime/wasm_blinky/boards/qemu_cortex_a53.conf
```kconfig
CONFIG_ARM_MMU=n
#CONFIG_TEST_RANDOM_GENERATOR=y
#CONFIG_TIMER_RANDOM_GENERATOR=y
```

## samples/subsys/display/cfb_shell/boards/longan_nano.conf
```kconfig
CONFIG_HEAP_MEM_POOL_SIZE=4096
CONFIG_CFB_SHELL_TRANSFER_BUFFER_SIZE=6400
CONFIG_CFB_SHELL_COMMAND_BUFFER_SIZE=128
```

## samples/subsys/fs/fs_sample/boards/rpi_5.conf
```kconfig
CONFIG_MAIN_STACK_SIZE=4096
CONFIG_FS_SAMPLE_CREATE_SOME_ENTRIES=n
CONFIG_FS_FATFS_MOUNT_MKFS=n

CONFIG_SHELL=y
CONFIG_FILE_SYSTEM_SHELL=y

CONFIG_LOG_MODE_MINIMAL=y
CONFIG_HEAP_MEM_POOL_SIZE=2097152
```

## soc/arm/renesas_ra/Kconfig
```kconfig
# Copyright (c) 2023 TOKITA Hiroshi <tokita.hiroshi@fujitsu.com>
# SPDX-License-Identifier: Apache-2.0

config SOC_FAMILY_RA
	bool
	select HAS_FSP

if SOC_FAMILY_RA

config SOC_FAMILY
	string
	default "renesas_ra"

source "soc/arm/renesas_ra/*/Kconfig.soc"

config DATA_FLASH_SIZE
	int "Data Flash Size in kB"
	default $(dt_node_reg_size_int,/soc/flash@1,0)
	help
	  DATA_FLASH region size

config DATA_FLASH_BASE_ADDRESS
	hex "Flash Base Address"
	default $(dt_node_reg_addr_hex,/soc/flash@1)
	help
	  DATA_FLASH address

config MCU_FEATURE_SET_0
	bool

config MCU_FEATURE_SET_A
	bool

config MCU_FEATURE_SET_B
	bool

config MCU_PACKAGE_BGA
	bool

config MCU_PACKAGE_LFQFP
	bool

config MCU_PACKAGE_LGA
	bool

config MCU_PACKAGE_LQFP
	bool

config MCU_PACKAGE_QFP
	bool

config MCU_PACKAGE_QFN
	bool

config MCU_PACKAGE_PINS_16
	bool

config MCU_PACKAGE_PINS_20
	bool

config MCU_PACKAGE_PINS_24
	bool

config MCU_PACKAGE_PINS_25
	bool

config MCU_PACKAGE_PINS_32
	bool

config MCU_PACKAGE_PINS_36
	bool

config MCU_PACKAGE_PINS_40
	bool

config MCU_PACKAGE_PINS_48
	bool

config MCU_PACKAGE_PINS_56
	bool

config MCU_PACKAGE_PINS_64
	bool

config MCU_PACKAGE_PINS_80
	bool

config MCU_PACKAGE_PINS_100
	bool

config MCU_PACKAGE_PINS_144
	bool

config MCU_PACKAGE_PINS_145
	bool

config MCU_PACKAGE_PINS_176
	bool

config MCU_PACKAGE_PINS
	int
	default 16 if MCU_PACKAGE_PINS_16
	default 20 if MCU_PACKAGE_PINS_20
	default 24 if MCU_PACKAGE_PINS_24
	default 25 if MCU_PACKAGE_PINS_25
	default 32 if MCU_PACKAGE_PINS_32
	default 36 if MCU_PACKAGE_PINS_36
	default 40 if MCU_PACKAGE_PINS_40
	default 48 if MCU_PACKAGE_PINS_48
	default 56 if MCU_PACKAGE_PINS_56
	default 64 if MCU_PACKAGE_PINS_64
	default 80 if MCU_PACKAGE_PINS_80
	default 100 if MCU_PACKAGE_PINS_100
	default 144 if MCU_PACKAGE_PINS_144
	default 145 if MCU_PACKAGE_PINS_145
	default 176 if MCU_PACKAGE_PINS_176
endif # SOC_FAMILY_RA
```
