## dts/bindings/timer/litex,timer0.yaml
```yaml
# Copyright (c) 2018 - 2019 Antmicro <www.antmicro.com>
# SPDX-License-Identifier: Apache-2.0

description: LiteX timer

compatible: "litex,timer0"

include: base.yaml

properties:
  reg:
    required: true

  interrupts:
    required: true

  clock-frequency:
    type: int
    description: |
      Frequency the timer counts at, in Hz. This is the LiteX sys_clk, which is
      not necessarily the CPU clock.
```

## dts/bindings/vhost/xen,virtio-mmio.yaml
```yaml
# Copyright (c) 2025 TOKITA Hiroshi
# SPDX-License-Identifier: Apache-2.0

description: Xen VHost MMIO device for VIRTIO backends

compatible: "xen,vhost-mmio"

include: base.yaml

properties:
  base:
    type: int
    required: true
    description: |
      Guest physical base address of the virtio MMIO register region used by
      this Xen vhost-mmio device.

  num-queues:
    type: int
    required: true
    description: |
      Number of virtqueues exposed by this device instance.

  queue-size-max:
    type: int
    required: true
    description: |
      Maximum number of entries supported in each virtqueue for this device.

  buffer-size:
    type: int
    required: true
    description: |
      Fixed data buffer capacity in bytes for each descriptor-chain head.
      The driver allocates this capacity, rounded up to Xen pages, at
      initialization. The sum of buffer lengths in a request must not exceed
      this value. Each buffer consumes whole mapping pages, including its
      page offset, so fragmented requests can exhaust the mapping capacity
      before reaching this byte limit. Requests exceeding either capacity
      are rejected. Virtqueue ring mappings are allocated separately.

  device-id:
    type: int
    required: true
    description: |
      Virtio device ID value, as defined by the VIRTIO Specification, used to
      identify the type of device implemented by this vhost-mmio instance.

  vendor-id:
    type: int
    default: 0
    description: |
      Virtio vendor ID value reported by the device. A value of 0 selects the
      implementation-defined or Xen-provided default vendor ID.

  device-features:
    type: int
    default: 0
    description: |
      Device-specific feature bits 0 through 31 advertised in addition to the
      transport feature bits supplied by the driver.

  stack-size:
    type: int
    description: |
      Stack size (in bytes) for the instance-specific work_q thread.

  priority:
    type: int
    description: |
      Priority for the instance-specific work_q thread.

  config-data:
    type: uint8-array
    description: |
     Configuration at 0x100+ in the '4.2.2 MMIO Device Register Layout' section
     of the VIRTIO Specification.
```

## dts/bindings/vhost/zephyr,vhost-pci-epf.yaml
```yaml
# Copyright (c) 2026 TOKITA Hiroshi
# SPDX-License-Identifier: Apache-2.0

description: |
  VIRTIO backend (VHost) exposed as a legacy (transitional) virtio-pci
  function through the PCI Endpoint Function framework.

  A host (root complex) connected to the endpoint port enumerates a
  legacy virtio-pci device whose virtqueues are served by this Zephyr
  device through the VHost API. The legacy register interface is used
  because it lives entirely in BAR0; the modern interface would require
  vendor-specific capabilities in the configuration space, which
  endpoint controller hardware generally cannot provide.

  One of "epc" or "epc-name" must be provided to select the PCI
  endpoint controller the function is bound to.

compatible: "zephyr,vhost-pci-epf"

include: base.yaml

properties:
  epc:
    type: phandle
    description: |
      PCI endpoint controller (EPC) device the function binds to.

  epc-name:
    type: string
    description: |
      Device name of the PCI endpoint controller the function binds to.
      Used when the EPC is not described in the devicetree. Ignored if
      "epc" is present.

  num-queues:
    type: int
    required: true
    description: |
      Number of virtqueues exposed by this device instance.

  queue-size-max:
    type: int
    required: true
    description: |
      Number of entries in each virtqueue. Must be a power of two. The
      legacy virtio-pci interface does not negotiate the queue size, so
      drivers use exactly this size.

  device-id:
    type: int
    required: true
    description: |
      Virtio device ID value, as defined by the VIRTIO Specification,
      identifying the type of device implemented by this instance. It is
      reported in the PCI subsystem device ID register, as required by
      the legacy interface.

  pci-device-id:
    type: int
    required: true
    description: |
      PCI device ID of the function. Transitional virtio-pci devices use
      0x1000 to 0x103f (for example 0x1000 for network, 0x1001 for
      block, 0x1005 for entropy).

  vendor-id:
    type: int
    default: 0x1af4
    description: |
      PCI vendor ID of the function. Defaults to the virtio vendor ID
      (Red Hat, 0x1af4).

  device-features:
    type: int
    default: 0
    description: |
      Device feature bits offered to the driver. The legacy interface
      carries only feature bits 0-31, so transport feature bits such as
      VIRTIO_F_VERSION_1 cannot be offered.

  config-data:
    type: uint8-array
    description: |
      Device-specific configuration space content, placed after the
      legacy virtio header in BAR0.

  stack-size:
    type: int
    description: |
      Stack size (in bytes) for the instance-specific work_q thread.

  priority:
    type: int
    description: |
      Priority for the instance-specific work_q thread.
```

## samples/drivers/video/capture/boards/m5stack_cores3_esp32s3_procpu.conf
```kconfig
CONFIG_ESP_SPIRAM=y
CONFIG_ESP_SPIRAM_HEAP_SIZE=4194304
CONFIG_SPIRAM_MODE_QUAD=y
CONFIG_DMA_ESP32_MAX_DESCRIPTOR_NUM=128
CONFIG_VIDEO_BUFFER_POOL_NUM_MAX=3
CONFIG_VIDEO_BUFFER_USE_SHARED_MULTI_HEAP=y
CONFIG_VIDEO_BUFFER_SMH_ATTRIBUTE=2
```

## soc/gigadevice/gd32/Kconfig
```kconfig
# Copyright (c) 2021, ATL Electronics
# SPDX-License-Identifier: Apache-2.0

config SOC_SERIES_GIGADEVICE_GD32VF103
	select RISCV
	select RISCV_PRIVILEGED
	select INCLUDE_RESET_VECTOR
	select XIP
```

## soc/gigadevice/gd32/Kconfig.defconfig
```kconfig
if SOC_GIGADEVICE_GD32VF103

config SYS_CLOCK_HW_CYCLES_PER_SEC
        default $(dt_node_int_prop_int,/cpus/,timebase-frequency)

config NUM_IRQS
	default 16

config MULTITHREADING
	default n

config KERNEL_ENTRY
	default "__nuclei_start"

config RISCV_TRAP_HANDLER_ALIGNMENT
	default 64

endif
```

## soc/gigadevice/gd32/Kconfig.soc
```kconfig
# Copyright (c) 2021, ATL Electronics
# SPDX-License-Identifier: Apache-2.0

config SOC_FAMILY_GIGADEVICE_GD32
	bool

config SOC_SERIES_GIGADEVICE_GD32VF103
	bool
	select SOC_FAMILY_GIGADEVICE_GD32

config SOC_GIGADEVICE_GD32VF103
	bool
	select SOC_SERIES_GIGADEVICE_GD32VF103

config SOC_FAMILY
	default "gigadevice_gd32" if SOC_FAMILY_GIGADEVICE_GD32

config SOC_SERIES
	default "gigadevice_gd32vf103" if SOC_SERIES_GIGADEVICE_GD32VF103

config SOC
	default "gigadevice_gd32vf103" if SOC_GIGADEVICE_GD32VF103
```

## soc/renesas/rcar/rcar_gen4/Kconfig.defconfig.r8a779g0
```kconfig
# Copyright (c) 2023 IoT.bzh
# Copyright (c) 2025 Renesas Electronics Corporation
# SPDX-License-Identifier: Apache-2.0

if SOC_R8A779G0_R52 || SOC_R8A779G0_A76

config NUM_IRQS
	default 991

# Arm Generic Timer frequency (Hz)
config SYS_CLOCK_HW_CYCLES_PER_SEC
	default $(dt_node_int_prop_int,/clocks/clock-cl16m_rt,clock-frequency) if SOC_R8A779G0_R52
	default 0 if SOC_R8A779G0_A76

# Clock Pulse Generator
config CLOCK_CONTROL
	default y

config TIMER_READS_ITS_FREQUENCY_AT_RUNTIME
        default n if SOC_R8A779G0_R52
        default y if SOC_R8A779G0_A76

endif # SOC_R8A779G0_R52 || SOC_R8A779G0_A76
```

## tests/drivers/entropy/api/boards/qemu_x86_64.conf
```kconfig
# Copyright (c) 2025 TOKITA Hiroshi
# SPDX-License-Identifier: Apache-2.0

CONFIG_PCIE_HOST=y
CONFIG_HEAP_MEM_POOL_SIZE=1024
```

## tests/drivers/pcie/epf/testcase.yaml
```yaml
tests:
  drivers.pcie.epf.api:
    tags:
      - drivers
      - pcie
    platform_allow:
      - native_sim
      - qemu_cortex_a53
    integration_platforms:
      - native_sim
```

## tests/drivers/vhost/pci_epf/testcase.yaml
```yaml
tests:
  drivers.vhost.pci_epf:
    tags:
      - drivers
      - vhost
    platform_allow:
      - native_sim
      - qemu_cortex_a53
    integration_platforms:
      - native_sim
```
