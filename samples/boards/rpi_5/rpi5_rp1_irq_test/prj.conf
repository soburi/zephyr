## CMakeLists.txt
```
# SPDX-License-Identifier: Apache-2.0

cmake_minimum_required(VERSION 3.20.0)

find_package(Zephyr REQUIRED HINTS $ENV{ZEPHYR_BASE})
project(rpi5_rp1_irq_test)

target_sources(app PRIVATE src/main.c)
```

## sample.yaml
```
sample:
  name: rpi5 rp1 irq test
  description: Verify RP1 MSI-X -> MIP -> GIC interrupt path on RPi5
common:
  tags: rpi5 rp1 pcie interrupt
  platform_allow:
    - rpi_5
  integration_platforms:
    - rpi_5
  harness: console
tests:
  sample.board.rpi5.rp1_irq_test:
    tags: rpi5 rp1 pcie
```

## prj.conf
```kconfig
CONFIG_PRINTK=y
CONFIG_PCIE=y
```

## src/gic_monitor.h
```c
/*
 * GIC State Monitor for RPi5 RP1 interrupt testing
 *
 * SPDX-License-Identifier: Apache-2.0
 */

#ifndef GIC_MONITOR_H
#define GIC_MONITOR_H

#include <zephyr/kernel.h>
#include <zephyr/sys/sys_io.h>
#include <zephyr/sys/util.h>

struct gic_monitor {
	uintptr_t dist_base;
};

/* GIC Distributor register offsets */
#define GICD_ISENABLER_OFF  0x100
#define GICD_ISPENDR_OFF    0x200
#define GICD_ICPENDR_OFF    0x280
#define GICD_ISACTIVER_OFF  0x300

static inline void gic_monitor_init(struct gic_monitor *mon, uintptr_t dist_base)
{
	mon->dist_base = dist_base;
}

static inline uint32_t gicd_read32(const struct gic_monitor *mon, uint32_t off)
{
	return sys_read32(mon->dist_base + off);
}

static inline void gicd_write32(const struct gic_monitor *mon, uint32_t off, uint32_t val)
{
	sys_write32(val, mon->dist_base + off);
}

/**
 * @brief Scan GIC pending register for active SPI interrupts
 * 
 * @param start_spi Starting SPI number (offset from 32)
 * @param end_spi Ending SPI number (offset from 32)
 */
static inline void gic_scan_pending(const struct gic_monitor *mon,
				    uint32_t start_intid,
				    uint32_t end_intid)
{
	printk("\n=== GIC Pending Scan (INTID %u-%u) ===\n",
	       start_intid, end_intid);
	
	for (uint32_t intid = start_intid; intid <= end_intid; intid++) {
		uint32_t reg_idx = intid / 32;
		uint32_t bit_idx = intid % 32;
		
		uint32_t pend_val = gicd_read32(mon, GICD_ISPENDR_OFF + (reg_idx * 4));
		uint32_t act_val = gicd_read32(mon, GICD_ISACTIVER_OFF + (reg_idx * 4));
		
		if (pend_val & BIT(bit_idx)) {
			printk("  [PENDING] INTID %u - bit %u in reg %u\n",
			       intid, bit_idx, reg_idx);
		}
		
		if (act_val & BIT(bit_idx)) {
			printk("  [ACTIVE]  INTID %u - bit %u in reg %u\n",
			       intid, bit_idx, reg_idx);
		}
	}
	
	printk("=== End GIC Scan ===\n\n");
}

/**
 * @brief Get pending status for a specific SPI
 */
static inline bool gic_is_intid_pending(const struct gic_monitor *mon, uint32_t intid)
{
	uint32_t reg_idx = intid / 32;
	uint32_t bit_idx = intid % 32;
	
	uint32_t pend_val = gicd_read32(mon, GICD_ISPENDR_OFF + (reg_idx * 4));
	return (pend_val & BIT(bit_idx)) != 0;
}

/**
 * @brief Clear pending for a specific SPI (write ICPENDR)
 */
static inline void gic_clear_intid_pending(const struct gic_monitor *mon, uint32_t intid)
{
	uint32_t reg_idx = intid / 32;
	uint32_t bit_idx = intid % 32;
	
	gicd_write32(mon, GICD_ICPENDR_OFF + (reg_idx * 4), BIT(bit_idx));
}

/**
 * @brief Dump all GIC ISPENDR registers (for wide scan)
 */
static inline void gic_dump_all_pending(const struct gic_monitor *mon)
{
	printk("\n=== GIC All ISPENDR Registers ===\n");
	for (int i = 0; i < 16; i++) {
		uint32_t val = gicd_read32(mon, GICD_ISPENDR_OFF + (i * 4));
		if (val) {
			printk("  ISPENDR[%d] = 0x%08x\n", i, val);
		}
	}
	printk("=== End ISPENDR Dump ===\n\n");
}

#endif /* GIC_MONITOR_H */
```

## src/mip_regs.h
```c
/*
 * MIP (MSI-X Interrupt Peripheral) Register Access for BCM2712
 *
 * Based on Linux kernel driver:
 * https://raw.githubusercontent.com/raspberrypi/linux/rpi-6.6.y/drivers/irqchip/irq-bcm2712-mip.c
 *
 * SPDX-License-Identifier: Apache-2.0
 */

#ifndef MIP_REGS_H
#define MIP_REGS_H

#include <zephyr/kernel.h>
#include <zephyr/sys/util.h>

#include "rp1_irq_test_config.h"

/*
 * MIP register offsets (from Linux driver)
 */
#define MIP_INT_RAISE        0x00
//#define MIP_INT_SETL          0x08
//#define MIP_INT_SETH          0x0c
#define MIP_INT_CLEARED      0x10
//#define MIP_INT_CLEAREDH      0x14
#define MIP_INT_CFGL_HOST     0x20
#define MIP_INT_CFGH_HOST     0x30
#define MIP_INT_MASKL_HOST    0x40
#define MIP_INT_MASKH_HOST    0x50
#define MIP_INT_MASKL_VPU     0x60
#define MIP_INT_MASKH_VPU     0x70
#define MIP_INT_STATUSL_HOST  0x80
#define MIP_INT_STATUSH_HOST  0x90
#define MIP_INT_STATUSL_VPU   0xa0
#define MIP_INT_STATUSH_VPU   0xb0

#define MIP_MSI_BASE_INTID  RP1_MIP_MSI_BASE_INTID
#define MIP_MSI_NUM_SPIS    RP1_MIP_MSI_NUM_SPIS
#define MIP_MSI_OFFSET      RP1_MIP_MSI_OFFSET
#define MIP_MSG_ADDR        RP1_MIP_MSG_ADDR
#define MIP_REG_SIZE        RP1_MIP_REG_SIZE

struct mip_state {
	uintptr_t base;
	uint32_t statusl;
	uint32_t statush;
	uint32_t maskl;
	uint32_t maskh;
	uint32_t raise;
};

static inline void mip_dump_raw(uintptr_t mip_base, size_t bytes)
{
	if (bytes == 0U) {
		return;
	}

	printk("\n=== MIP Raw Dump (0x00..0x%02x) ===\n",
	       (unsigned int)(bytes - sizeof(uint32_t)));

	for (size_t off = 0U; off < bytes; off += 16U) {
		uint32_t v0 = sys_read32(mip_base + off + 0U);
		uint32_t v1 = sys_read32(mip_base + off + 4U);
		uint32_t v2 = sys_read32(mip_base + off + 8U);
		uint32_t v3 = sys_read32(mip_base + off + 12U);

		printk("  0x%02x: %08x %08x %08x %08x\n",
		       (unsigned int)off, v0, v1, v2, v3);
	}

	printk("=== End MIP Raw Dump ===\n\n");
}

/**
 * @brief Read MIP status registers
 */
static inline void mip_read_status(uintptr_t mip_base, struct mip_state *state)
{
	volatile uint32_t *regs = (volatile uint32_t *)mip_base;
	
	state->base = mip_base;
	state->statusl = regs[MIP_INT_STATUSL_HOST / 4];
	state->statush = regs[MIP_INT_STATUSH_HOST / 4];
	state->maskl = regs[MIP_INT_MASKL_HOST / 4];
	state->maskh = regs[MIP_INT_MASKH_HOST / 4];
	state->raise = regs[MIP_INT_RAISE / 4];
}

/**
 * @brief Dump MIP state to console
 */
static inline void mip_dump_state(const struct mip_state *state)
{
	printk("\n=== MIP State (base: 0x%llx) ===\n",
	       (unsigned long long)state->base);
	printk("  STATUS_L: 0x%08x\n", state->statusl);
	printk("  STATUS_H: 0x%08x\n", state->statush);
	printk("  MASK_L:   0x%08x\n", state->maskl);
	printk("  MASK_H:   0x%08x\n", state->maskh);
	printk("  RAISED: 0x%08x\n", state->raise);
	
	/* Show which bits are set in status */
	if (state->statusl || state->statush) {
		printk("  Active vectors:\n");
		for (int i = 0; i < 32; i++) {
			if (state->statusl & BIT(i)) {
				printk("    - Vector %d (INTID %d)\n",
				       i, MIP_MSI_BASE_INTID + i);
			}
		}
		for (int i = 0; i < 32; i++) {
			if (state->statush & BIT(i)) {
				printk("    - Vector %d (INTID %d)\n",
				       i + 32, MIP_MSI_BASE_INTID + i + 32);
			}
		}
	}
	printk("=== End MIP State ===\n\n");
}

/**
 * @brief Initialize MIP (unmask all, clear status)
 */
static inline void mip_init(uintptr_t mip_base)
{
	volatile uint32_t *regs = (volatile uint32_t *)mip_base;
	
	printk("Initializing MIP at 0x%llx\n",
	       (unsigned long long)mip_base);
	
	/* Clear all status */
	regs[MIP_INT_CLEARED / 4] = 0xffffffff;
	//regs[MIP_INT_CLEAREDH / 4] = 0xffffffff;
	
	/* Host unmasked, VPU masked */
	regs[MIP_INT_MASKL_HOST / 4] = 0x00000000;
	regs[MIP_INT_MASKH_HOST / 4] = 0x00000000;
	regs[MIP_INT_MASKL_VPU / 4] = 0xffffffff;
	regs[MIP_INT_MASKH_VPU / 4] = 0xffffffff;
	
	/* Configure all as edge-triggered (all 1s in Linux) */
	regs[MIP_INT_CFGL_HOST / 4] = 0xffffffff;
	regs[MIP_INT_CFGH_HOST / 4] = 0xffffffff;
	
	printk("MIP initialized\n");
}

/**
 * @brief Raise a MIP vector (best-effort; may be read-only on some revisions)
 */
static inline void mip_raise_vector(uintptr_t mip_base, uint32_t vector)
{
	volatile uint32_t *regs = (volatile uint32_t *)mip_base;

	if (vector < 32U) {
		regs[MIP_INT_RAISE / 4] = BIT(vector);
	}
}
/*
static inline void mip_set_vector_undoc(uintptr_t mip_base, uint32_t vector)
{
	volatile uint32_t *regs = (volatile uint32_t *)mip_base;

	if (vector < 32U) {
		regs[MIP_INT_SETL / 4] = BIT(vector);
	} else if (vector < 64U) {
		regs[MIP_INT_SETH / 4] = BIT(vector - 32U);
	}
}
*/
/**
 * @brief Clear specific MIP vector
 */
static inline void mip_clear_vector(uintptr_t mip_base, uint32_t vector)
{
	volatile uint32_t *regs = (volatile uint32_t *)mip_base;
	
	if (vector < 32) {
		regs[MIP_INT_CLEARED / 4] = BIT(vector);
	}
}

#endif /* MIP_REGS_H */
```

## src/rp1_irq_test_config.h
```c
/*
 * RP1 IRQ test configuration.
 *
 * Fill in these values from a known-good DTB (Linux firmware DTB or
 * a Zephyr overlay). Use 0 to skip steps safely.
 *
 * SPDX-License-Identifier: Apache-2.0
 */

#ifndef RP1_IRQ_TEST_CONFIG_H
#define RP1_IRQ_TEST_CONFIG_H

/* MIP (MSI-X Interrupt Peripheral) register window */
#define RP1_MIP_BASE_ADDR      0x1000130000ULL
#define RP1_MIP_REG_SIZE       0x00c0U

/* MSI-X message (doorbell) address expected by MIP */
#define RP1_MIP_MSG_ADDR       0x000000fffffff000ULL

/*
 * CPU-accessible alias of the MSI doorbell window.
 *
 * Firmware DT commonly describes MIP with two reg entries:
 *   - MIP registers:    0x1000130000 (size 0xc0)
 *   - PCIe MSI window:  0xff_ffff_f000 (size 0x1000)
 *
 * RP1 MSI-X must use the PCIe MSI window address (RP1_MIP_MSG_ADDR).
 * But a CPU-side devmem-style "doorbell" write should target the CPU-visible
 * alias (usually MIP base + 0), not the PCIe address, otherwise the write can
 * hit nothing (or the wrong thing) and you will not see MIP/GIC activity.
 */
#ifndef RP1_MIP_MSG_ADDR_CPU
#define RP1_MIP_MSG_ADDR_CPU   0x1000130000ULL
#endif

/* MIP output SPI range (GIC INTID base + count) */
#define RP1_MIP_MSI_BASE_INTID 0x80U
#define RP1_MIP_MSI_NUM_SPIS   0x40U
#define RP1_MIP_MSI_OFFSET     0x00U

/* MSI-X vector used for the test */
#define RP1_MSIX_TEST_VECTOR   0U

/*
 * Sweep step for locating the RP1 config block within mapped BARs.
 * Smaller values increase coverage at the cost of more test writes.
 */
#define RP1_CFG_SWEEP_STEP     0x100U

/*
 * Optional CPU-generated MSI doorbell test to validate MIP -> GIC path.
 * Disable if the doorbell address is not CPU-accessible on your setup.
 */
#define RP1_ENABLE_CPU_DOORBELL_TEST 0U

/*
 * Optional MIP self-raise test (writes MIP_INT_RAISED).
 * This is a best-effort sanity check; some revisions may treat it as read-only.
 */
#define RP1_ENABLE_MIP_RAISE_TEST 1U

/* Dump raw MIP registers for offset verification */
#define RP1_ENABLE_MIP_RAW_DUMP 1U
#define RP1_MIP_RAW_DUMP_BYTES  0x80U

/*
 * Optional RP1 GPIO PCIe interrupt force test.
 * This uses the PCIe host INTE/INTF/INTS registers in IO_BANK.
 */
#define RP1_ENABLE_GPIO_FORCE_TEST 1U
#define RP1_GPIO_FORCE_BANK        0U
#define RP1_GPIO_FORCE_PIN         0U

/*
 * BAR index that exposes the RP1 PCIe config block (MSIX_CFG/INTSTAT).
 * Use 0xFF to reuse the MSI-X table BAR.
 */
#define RP1_CFG_BAR_INDEX      0x01U

/*
 * Optional forced BAR mapping for the RP1 PCIe config block.
 * Use when pcie_get_mbar() fails due to BAR sizing writes being rejected.
 * Set to 0 to disable.
 */
#define RP1_CFG_BAR_PHYS_ADDR  0x0000001f00000000ULL
#define RP1_CFG_BAR_SIZE       0x00400000U

/*
 * Optional BAR programming for RP1 (when firmware has not assigned BAR1/2).
 * Set RP1_ENABLE_BAR_PROGRAM to 0 to skip.
 */
#define RP1_ENABLE_BAR_PROGRAM 0U
#define RP1_BAR1_PHYS_ADDR     0x0000001f00000000ULL
#define RP1_BAR1_SIZE          0x00400000U

/*
 * Use PCIe config space for MSIX_CFG/INTSTAT access instead of MMIO BAR.
 * This is recommended for RP1 MSI-X test registers.
 */
#define RP1_CFG_USE_PCIE_CFG   0U

/*
 * Base offset within the RP1 PCIe BAR for the endpoint config block.
 * This is added to RP1_PCIE_APBS_BASE when using BAR MMIO access.
 */
#define RP1_PCIE_CFG_BASE_OFFSET 0x000U

/*
 * RP1 PCIe APBS base and set/clear window offsets (from Linux rp1 driver).
 * Used when accessing MSIX_CFG/INTSTAT via BAR MMIO.
 */
#define RP1_PCIE_APBS_BASE     0x00108000U
#define RP1_PCIE_REG_SET_OFFSET 0x00000800U
#define RP1_PCIE_REG_CLR_OFFSET 0x00000c00U
#define RP1_USE_APBS_SETCLR     1U

/* GPIO PCIe interrupt offsets (override if your RP1 revision differs) */
#define RP1_GPIO_PCIE_INTE_OFFSET 0x128U
#define RP1_GPIO_PCIE_INTF_OFFSET 0x12cU
#define RP1_GPIO_PCIE_INTS_OFFSET 0x130U

/*
 * Root Complex inbound mapping for MSI doorbell.
 *
 * When enabled, main.c programs RC_BAR1 and UBUS BAR1 remap so that MSI writes
 * to RP1_MIP_MSG_ADDR reach the MIP block at RP1_MIP_BASE_ADDR.
 */
#define RP1_ENABLE_RC_BAR1_PROGRAM 0U

/* Optional expected PCIe RC/UBUS register values for comparison */
#define RP1_EXPECT_RC_BAR1_LO    0xffffffffU
#define RP1_EXPECT_RC_BAR1_HI    0xffffffffU
#define RP1_EXPECT_UBUS_BAR1_LO  0xffffffffU
#define RP1_EXPECT_UBUS_BAR1_HI  0xffffffffU
#define RP1_EXPECT_RC_BAR2_LO    0xffffffffU
#define RP1_EXPECT_RC_BAR2_HI    0xffffffffU
#define RP1_EXPECT_UBUS_BAR2_LO  0xffffffffU
#define RP1_EXPECT_UBUS_BAR2_HI  0xffffffffU

#endif /* RP1_IRQ_TEST_CONFIG_H */
```

## src/rp1_irq_trigger.h
```c
/*
 * RP1 Interrupt Trigger Functions
 *
 * Based on RP1 Peripherals documentation:
 * https://datasheets.raspberrypi.com/rp1/rp1-peripherals.pdf
 *
 * SPDX-License-Identifier: Apache-2.0
 */

#ifndef RP1_IRQ_TRIGGER_H
#define RP1_IRQ_TRIGGER_H

#include <zephyr/kernel.h>
#include <zephyr/drivers/pcie/pcie.h>
#include <zephyr/sys/sys_io.h>

/*
 * RP1 PCIe configuration registers (APBS block)
 * Base offset from RP1 BAR (typically BAR1) for the PCIe APBS window.
 */
#ifndef RP1_PCIE_CFG_BASE_OFFSET
#define RP1_PCIE_CFG_BASE_OFFSET 0x00000000U
#endif

#ifndef RP1_CFG_USE_PCIE_CFG
#define RP1_CFG_USE_PCIE_CFG 0U
#endif

#ifndef RP1_PCIE_APBS_BASE
#define RP1_PCIE_APBS_BASE 0x00108000U
#endif

#ifndef RP1_PCIE_REG_SET_OFFSET
#define RP1_PCIE_REG_SET_OFFSET 0x00000800U
#endif

#ifndef RP1_PCIE_REG_CLR_OFFSET
#define RP1_PCIE_REG_CLR_OFFSET 0x00000c00U
#endif

#ifndef RP1_USE_APBS_SETCLR
#define RP1_USE_APBS_SETCLR 1U
#endif

#if RP1_CFG_USE_PCIE_CFG
#define RP1_PCIE_CFG_BASE   0x00000000U
#define RP1_MSIX_CFG(n)     (RP1_PCIE_CFG_BASE + 0x8c + ((n) * 4))
#define RP1_PCIE_INTSTATL   (RP1_PCIE_CFG_BASE + 0x0050)
#define RP1_PCIE_INTSTATH   (RP1_PCIE_CFG_BASE + 0x0054)
#else
#define RP1_PCIE_CFG_BASE   (RP1_PCIE_APBS_BASE + RP1_PCIE_CFG_BASE_OFFSET)
#define RP1_MSIX_CFG(n)     (RP1_PCIE_CFG_BASE + 0x8 + ((n) * 4))
#define RP1_PCIE_INTSTATL   (RP1_PCIE_CFG_BASE + 0x0050)
#define RP1_PCIE_INTSTATH   (RP1_PCIE_CFG_BASE + 0x0054)
#endif

/* MSI-X CFG bits */
#define RP1_MSIX_CFG_ENABLE  BIT(0)
#define RP1_MSIX_CFG_TEST    BIT(8)   /* Software test bit - ORed with interrupt source */
#define RP1_MSIX_CFG_IACK_EN BIT(16)  /* IACK enable */

/*
 * GPIO Interrupt registers (Section 5.3.4)
 * These are for GPIO bank interrupts to host via PCIe
 */
#define RP1_IO_BANK0_BASE   0xd0000  /* From DT: reg = <0x1f 0xd0000 0x4000> */
#define RP1_IO_BANK1_BASE   0xe0000
#define RP1_IO_BANK2_BASE   0xf0000

#ifndef RP1_GPIO_PCIE_INTE_OFFSET
#define RP1_GPIO_PCIE_INTE_OFFSET 0x128U
#endif
#ifndef RP1_GPIO_PCIE_INTF_OFFSET
#define RP1_GPIO_PCIE_INTF_OFFSET 0x12cU
#endif
#ifndef RP1_GPIO_PCIE_INTS_OFFSET
#define RP1_GPIO_PCIE_INTS_OFFSET 0x130U
#endif

/* Per-bank interrupt registers for PCIe (host) direction */
#define RP1_GPIO_PCIE_INTE(bank, n)  ((bank) + RP1_GPIO_PCIE_INTE_OFFSET + ((n) * 0x30))
#define RP1_GPIO_PCIE_INTF(bank, n)  ((bank) + RP1_GPIO_PCIE_INTF_OFFSET + ((n) * 0x30))
#define RP1_GPIO_PCIE_INTS(bank, n)  ((bank) + RP1_GPIO_PCIE_INTS_OFFSET + ((n) * 0x30))

struct rp1_trigger {
	uintptr_t rp1_base;  /* RP1 MMIO base (from BAR, mapped) */
	pcie_bdf_t bdf;
	bool use_cfg;
	bool initialized;
};

/**
 * @brief Initialize RP1 trigger (map base address)
 */
static inline bool rp1_trigger_init(struct rp1_trigger *trig, uintptr_t rp1_base)
{
	if (!rp1_base) {
		printk("ERROR: Invalid RP1 base address\n");
		return false;
	}
	
	trig->rp1_base = rp1_base;
	trig->use_cfg = false;
	trig->initialized = true;
	
	printk("RP1 trigger initialized with base 0x%llx\n",
	       (unsigned long long)rp1_base);
	return true;
}

/**
 * @brief Initialize RP1 trigger using PCIe config space
 */
static inline bool rp1_trigger_init_cfg(struct rp1_trigger *trig, pcie_bdf_t bdf)
{
	trig->bdf = bdf;
	trig->use_cfg = true;
	trig->initialized = true;

	printk("RP1 trigger initialized with PCIe config access (BDF 0x%08x)\n", bdf);
	return true;
}

static inline uint32_t rp1_cfg_read(const struct rp1_trigger *trig, uint32_t off)
{
	if (trig->use_cfg) {
		return pcie_conf_read(trig->bdf, off / 4U);
	}

	return sys_read32(trig->rp1_base + off);
}

static inline void rp1_cfg_write(const struct rp1_trigger *trig,
				 uint32_t off, uint32_t val)
{
	if (trig->use_cfg) {
		pcie_conf_write(trig->bdf, off / 4U, val);
		return;
	}

	sys_write32(val, trig->rp1_base + off);
}

static inline void rp1_cfg_set(const struct rp1_trigger *trig,
			       uint32_t off, uint32_t mask)
{
	if (trig->use_cfg) {
		uint32_t val = rp1_cfg_read(trig, off);
		rp1_cfg_write(trig, off, val | mask);
		return;
	}

#if RP1_USE_APBS_SETCLR
	sys_write32(mask, trig->rp1_base + off + RP1_PCIE_REG_SET_OFFSET);
#else
	uint32_t val = rp1_cfg_read(trig, off);
	sys_write32(val | mask, trig->rp1_base + off);
#endif
}

static inline void rp1_cfg_clear(const struct rp1_trigger *trig,
				 uint32_t off, uint32_t mask)
{
	if (trig->use_cfg) {
		uint32_t val = rp1_cfg_read(trig, off);
		rp1_cfg_write(trig, off, val & ~mask);
		return;
	}

#if RP1_USE_APBS_SETCLR
	sys_write32(mask, trig->rp1_base + off + RP1_PCIE_REG_CLR_OFFSET);
#else
	uint32_t val = rp1_cfg_read(trig, off);
	sys_write32(val & ~mask, trig->rp1_base + off);
#endif
}

/**
 * @brief Trigger interrupt via MSI-X TEST bit
 * 
 * This uses the MSI-X CFG TEST bit which ORs with the actual interrupt source.
 * Most reliable way to generate a test interrupt.
 */
static inline void rp1_trigger_msix_test(struct rp1_trigger *trig, uint32_t vector)
{
	if (!trig->initialized) {
		printk("ERROR: Trigger not initialized\n");
		return;
	}
	
	printk("\n>>> Triggering RP1 interrupt via MSI-X TEST (vector %u) <<<\n", vector);
	
	/* Read current config */
	uint32_t cfg = rp1_cfg_read(trig, RP1_MSIX_CFG(vector));
	printk("  Current MSIX_CFG[%u]: 0x%08x\n", vector, cfg);
	
	/* Set ENABLE, TEST, and IACK_EN for clean edge delivery */
	rp1_cfg_set(trig, RP1_MSIX_CFG(vector),
		    RP1_MSIX_CFG_ENABLE | RP1_MSIX_CFG_TEST | RP1_MSIX_CFG_IACK_EN);
	
	printk("  New MSIX_CFG[%u]: 0x%08x\n", vector,
	       rp1_cfg_read(trig, RP1_MSIX_CFG(vector)));
	printk(">>> Interrupt should now be triggered <<<\n\n");
}

/**
 * @brief Trigger MSI-X TEST bit without console output (for sweeps)
 */
static inline void rp1_trigger_msix_test_quiet(struct rp1_trigger *trig, uint32_t vector)
{
	if (!trig->initialized) {
		return;
	}

	rp1_cfg_set(trig, RP1_MSIX_CFG(vector),
		    RP1_MSIX_CFG_ENABLE | RP1_MSIX_CFG_TEST | RP1_MSIX_CFG_IACK_EN);
}

/**
 * @brief Clear MSI-X TEST bit
 */
static inline void rp1_clear_msix_test(struct rp1_trigger *trig, uint32_t vector)
{
	if (!trig->initialized) {
		return;
	}
	
	rp1_cfg_clear(trig, RP1_MSIX_CFG(vector), RP1_MSIX_CFG_TEST);
	
	printk("Cleared MSI-X TEST bit for vector %u\n", vector);
}

/**
 * @brief Clear MSI-X TEST bit without console output (for sweeps)
 */
static inline void rp1_clear_msix_test_quiet(struct rp1_trigger *trig, uint32_t vector)
{
	if (!trig->initialized) {
		return;
	}

	rp1_cfg_clear(trig, RP1_MSIX_CFG(vector), RP1_MSIX_CFG_TEST);
}

/**
 * @brief Read RP1 PCIe interrupt status
 */
static inline void rp1_read_intstatus(struct rp1_trigger *trig)
{
	if (!trig->initialized) {
		return;
	}
	
	uint32_t sl = rp1_cfg_read(trig, RP1_PCIE_INTSTATL);
	uint32_t sh = rp1_cfg_read(trig, RP1_PCIE_INTSTATH);
	
	printk("\n=== RP1 PCIe INTSTAT ===\n");
	printk("  INTSTATL [31:0]:  0x%08x\n", sl);
	printk("  INTSTATH [63:32]: 0x%08x\n", sh);
	
	if (sl || sh) {
		printk("  Active interrupt sources:\n");
		for (int i = 0; i < 32; i++) {
			if (sl & BIT(i)) {
				printk("    - Bit %d\n", i);
			}
		}
		for (int i = 0; i < 32; i++) {
			if (sh & BIT(i)) {
				printk("    - Bit %d\n", i + 32);
			}
		}
	}
	printk("=== End INTSTAT ===\n\n");
}

/**
 * @brief Trigger GPIO interrupt via FORCE (alternative method)
 * 
 * Note: Requires GPIO to be configured and enabled.
 * Less reliable for initial testing than MSI-X TEST.
 */
static inline void rp1_trigger_gpio_force(struct rp1_trigger *trig,
					  uint32_t bank,
					  uint32_t gpio)
{
	if (!trig->initialized) {
		return;
	}

	if (trig->use_cfg) {
		printk("GPIO force requires MMIO base, not PCIe config access\n");
		return;
	}
	
	uint64_t bank_base;
	switch (bank) {
	case 0:
		bank_base = RP1_IO_BANK0_BASE;
		break;
	case 1:
		bank_base = RP1_IO_BANK1_BASE;
		break;
	case 2:
		bank_base = RP1_IO_BANK2_BASE;
		break;
	default:
		printk("Invalid GPIO bank %u\n", bank);
		return;
	}
	
	uint32_t reg = gpio / 8;  /* 4 interrupts per register */
	uint32_t shift = (gpio % 8) * 4;
	uint32_t mask = (0xfU << shift);
	
	uintptr_t inte = trig->rp1_base +
		RP1_GPIO_PCIE_INTE(bank_base, reg);
	uintptr_t intf = trig->rp1_base +
		RP1_GPIO_PCIE_INTF(bank_base, reg);
	uintptr_t ints = trig->rp1_base +
		RP1_GPIO_PCIE_INTS(bank_base, reg);
	
	printk("Forcing GPIO interrupt: bank %u, gpio %u\n", bank, gpio);
	uint32_t before = sys_read32(ints);
	sys_write32(sys_read32(inte) | mask, inte);
	sys_write32(mask, intf);  /* Force all edge types */
	uint32_t after = sys_read32(ints);

	printk("  PCIE_INTS before: 0x%08x\n", before);
	printk("  PCIE_INTS after:  0x%08x\n", after);
}

#endif /* RP1_IRQ_TRIGGER_H */
```

## src/rp1_pcie.h
```c
/*
 * RP1 PCIe Device and MSI-X Control
 *
 * SPDX-License-Identifier: Apache-2.0
 */

#ifndef RP1_PCIE_H
#define RP1_PCIE_H

#include <zephyr/kernel.h>
#include <zephyr/kernel/mm.h>
#include <zephyr/drivers/pcie/pcie.h>
#include <zephyr/sys/device_mmio.h>

/* RP1 PCIe identifiers */
#define RP1_VENDOR_ID  0x1de4
#define RP1_DEVICE_ID  0x0001

/* PCIe capability ID */
#define PCI_CAP_ID_MSIX    0x11

/* MSI-X Capability registers */
#define PCI_MSIX_CTRL      0x02  /* Message Control */
#define PCI_MSIX_TABLE     0x04  /* Table offset/BAR */
#define PCI_MSIX_PBA       0x08  /* Pending Bit Array offset/BAR */

#define PCI_MSIX_ENABLE    0x8000
#define PCI_MSIX_MASK      0x4000

/* MSI-X Table Entry structure (16 bytes) */
struct msix_entry {
	uint32_t msg_addr_lo;
	uint32_t msg_addr_hi;
	uint32_t msg_data;
	uint32_t vector_control;
};

struct rp1_bar_map {
	struct pcie_bar bar;
	mm_reg_t vaddr;
	bool mapped;
};

struct rp1_device {
	pcie_bdf_t bdf;
	bool found;
	uint32_t msix_cap_offset;
	uint32_t msix_table_bar;
	uint32_t msix_table_offset;
	mm_reg_t msix_table_addr;
	uint16_t msix_count;
	struct rp1_bar_map msix_bar;
	struct rp1_bar_map cfg_bar;
};

struct rp1_find_ctx {
	pcie_bdf_t bdf;
	bool found;
};

static inline bool rp1_scan_cb(pcie_bdf_t bdf, pcie_id_t id, void *cb_data)
{
	struct rp1_find_ctx *ctx = cb_data;

	if ((PCIE_ID_TO_VEND(id) == RP1_VENDOR_ID) &&
	    (PCIE_ID_TO_DEV(id) == RP1_DEVICE_ID)) {
		ctx->bdf = bdf;
		ctx->found = true;
		return false;
	}

	return true;
}

/**
 * @brief Find RP1 PCIe device
 */
static inline bool rp1_find_device(struct rp1_device *dev)
{
	struct rp1_find_ctx ctx = {
		.bdf = PCIE_BDF_NONE,
		.found = false,
	};
	struct pcie_scan_opt opt = {
		.bus = 0,
		.cb = rp1_scan_cb,
		.cb_data = &ctx,
		.flags = PCIE_SCAN_RECURSIVE,
	};
	
	printk("Searching for RP1 device (VID:0x%04x, DID:0x%04x)...\n",
	       RP1_VENDOR_ID, RP1_DEVICE_ID);
	
	if (pcie_scan(&opt) < 0 || !ctx.found) {
		printk("RP1 device not found\n");
		dev->found = false;
		return false;
	}
	
	dev->bdf = ctx.bdf;
	dev->found = true;
	
	uint32_t id = pcie_conf_read(dev->bdf, PCIE_CONF_ID);
	printk("Found RP1: BDF 0x%08x, VID/DID: 0x%08x\n", dev->bdf, id);
	
	return true;
}

/**
 * @brief Find MSI-X capability
 */
static inline bool rp1_find_msix_cap(struct rp1_device *dev)
{
	if (!dev->found) {
		return false;
	}
	
	printk("Searching for MSI-X capability...\n");
	
	uint32_t cap_ptr = PCIE_CONF_CAPPTR_FIRST(
		pcie_conf_read(dev->bdf, PCIE_CONF_CAPPTR));
	
	while (cap_ptr) {
		uint32_t cap = pcie_conf_read(dev->bdf, cap_ptr);
		uint8_t cap_id = PCIE_CONF_CAP_ID(cap);
		
		if (cap_id == PCI_CAP_ID_MSIX) {
			dev->msix_cap_offset = cap_ptr;
			
			uint16_t ctrl = (cap >> 16) & 0xffff;
			dev->msix_count = (ctrl & 0x7ff) + 1;
			
			uint32_t table_reg = pcie_conf_read(
				dev->bdf, cap_ptr + (PCI_MSIX_TABLE / 4));
			dev->msix_table_bar = table_reg & 0x7;
			dev->msix_table_offset = table_reg & ~0x7;
			
			printk("  MSI-X cap at cfg word %u\n", cap_ptr);
			printk("  MSI-X vectors: %u\n", dev->msix_count);
			printk("  MSI-X table: BAR%u + 0x%x\n",
			       dev->msix_table_bar, dev->msix_table_offset);
			
			return true;
		}
		
		cap_ptr = PCIE_CONF_CAP_NEXT(cap);
	}
	
	printk("MSI-X capability not found\n");
	return false;
}

/**
 * @brief Enable MSI-X
 */
static inline void rp1_enable_msix(struct rp1_device *dev)
{
	if (!dev->found || !dev->msix_cap_offset) {
		return;
	}
	
	printk("Enabling MSI-X...\n");
	
	uint32_t cmd = pcie_conf_read(dev->bdf, PCIE_CONF_CMDSTAT);
	cmd |= (PCIE_CONF_CMDSTAT_MEM | PCIE_CONF_CMDSTAT_MASTER);
	pcie_conf_write(dev->bdf, PCIE_CONF_CMDSTAT, cmd);
	
	uint32_t cap = pcie_conf_read(dev->bdf, dev->msix_cap_offset);
	uint16_t ctrl = (cap >> 16) & 0xffff;
	ctrl |= PCI_MSIX_ENABLE;
	ctrl &= ~PCI_MSIX_MASK;
	cap = (cap & 0xffff) | ((uint32_t)ctrl << 16);
	pcie_conf_write(dev->bdf, dev->msix_cap_offset, cap);
	
	printk("MSI-X enabled\n");
}

/**
 * @brief Map a PCIe BAR to a CPU-accessible virtual address
 */
static inline bool rp1_map_bar(pcie_bdf_t bdf, uint32_t bar_idx,
			       struct rp1_bar_map *map)
{
	if (!pcie_get_mbar(bdf, bar_idx, &map->bar)) {
		printk("ERROR: BAR%u not available\n", bar_idx);
		map->mapped = false;
		return false;
	}
	
	device_map(&map->vaddr, map->bar.phys_addr, map->bar.size,
		   K_MEM_CACHE_NONE);
	map->mapped = true;
	
	printk("Mapped BAR%u: phys 0x%llx, size 0x%zx\n",
	       bar_idx,
	       (unsigned long long)map->bar.phys_addr,
	       map->bar.size);
	return true;
}

/**
 * @brief Map the MSI-X table BAR
 */
static inline bool rp1_map_msix_table(struct rp1_device *dev)
{
	if (!dev->found) {
		return false;
	}
	
	if (!rp1_map_bar(dev->bdf, dev->msix_table_bar, &dev->msix_bar)) {
		return false;
	}
	
	dev->msix_table_addr = dev->msix_bar.vaddr;
	return true;
}

/**
 * @brief Map RP1 config BAR (MSIX_CFG/INTSTAT)
 */
static inline bool rp1_map_cfg_bar(struct rp1_device *dev, uint32_t bar_idx)
{
	if (!dev->found) {
		return false;
	}
	
	return rp1_map_bar(dev->bdf, bar_idx, &dev->cfg_bar);
}

/**
 * @brief Setup MSI-X table entry (requires BAR mapping)
 */
static inline bool rp1_setup_msix_entry(struct rp1_device *dev,
					uint32_t vector,
					uint64_t msg_addr,
					uint32_t msg_data)
{
	if (!dev->msix_bar.mapped || !dev->msix_table_addr) {
		printk("ERROR: MSI-X table not mapped\n");
		return false;
	}
	
	if (vector >= dev->msix_count) {
		printk("ERROR: MSI-X vector %u out of range (max %u)\n",
		       vector, dev->msix_count - 1);
		return false;
	}
	
	volatile struct msix_entry *table =
		(volatile struct msix_entry *)(dev->msix_table_addr +
					       dev->msix_table_offset);
	
	printk("Setting MSI-X vector %u:\n", vector);
	printk("  Address: 0x%llx\n", (unsigned long long)msg_addr);
	printk("  Data: 0x%x\n", msg_data);
	
	table[vector].msg_addr_lo = (uint32_t)msg_addr;
	table[vector].msg_addr_hi = (uint32_t)(msg_addr >> 32);
	table[vector].msg_data = msg_data;
	table[vector].vector_control = 0;  /* Unmask */

	return true;
}

#endif /* RP1_PCIE_H */
```
