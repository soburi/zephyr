## soc/arm/renesas_ra/ra4m1/Kconfig.defconfig.series
```kconfig
# Copyright (c) 2023 TOKITA Hiroshi <tokita.hiroshi@fujitsu.com>
# SPDX-License-Identifier: Apache-2.0

if SOC_SERIES_RA4M1

source "soc/arm/renesas_ra/ra4m1/Kconfig.defconfig.r7fa4*"

config SOC_SERIES
	default "ra4m1"

config NUM_IRQS
	default 40

endif # SOC_SERIES_RA4M1
```

## soc/arm/renesas_ra/ra6e1/Kconfig.defconfig.r7fa6e10f2cfp
```kconfig
# Copyright (c) 2023 TOKITA Hiroshi <tokita.hiroshi@fujitsu.com>
# SPDX-License-Identifier: Apache-2.0

if SOC_R7FA6E10F2CFP

config SOC
	default "r7fa6e10f2cfp"

endif # SOC_R7FA6E10f2CFP
```

## soc/arm/renesas_ra/ra6e1/Kconfig.defconfig.series
```kconfig
# Copyright (c) 2023 TOKITA Hiroshi <tokita.hiroshi@fujitsu.com>
# SPDX-License-Identifier: Apache-2.0

if SOC_SERIES_RA6E1

source "soc/arm/renesas_ra/ra6e1/Kconfig.defconfig.r7fa6*"

config SOC_SERIES
	default "ra6e1"

config NUM_IRQS
	default 40

endif # SOC_SERIES_RA6E1
```

## soc/arm/renesas_ra/ra6e1/Kconfig.soc
```kconfig
# Copyright (c) 2023 TOKITA Hiroshi <tokita.hiroshi@fujitsu.com>
# SPDX-License-Identifier: Apache-2.0

choice
	prompt "Renesas RA6E1 SoC Selection"
	depends on SOC_SERIES_RA6E1

config SOC_R7FA6E10F2CFP
	bool "R7FA6E10F2CFP"
	select MCU_PACKAGE_QFP
	select MCU_PACKAGE_PINS_100
	select MCU_FEATURE_SET_0

endchoice
```

## soc/raspberrypi/rpi_pico/common/Kconfig
```kconfig
# Copyright (c) 2024 TOKITA Hiroshi
# SPDX-License-Identifier: Apache-2.0

config RPI_PICO_BINARY_INFO
	bool "Generate RaspberryPi Pico binary info"
	default y
	help
	  Binary info is able to embed machine readable information with the binary in flash.
	  It can read with picotool(https://github.com/raspberrypi/picotool).
	  Binary info is generated automatically when this option is enabled, 

if RPI_PICO_BINARY_INFO

config RPI_PICO_BINARY_INFO_PROGRAM_NAME
	bool "Generate program name in binary info"

config RPI_PICO_BINARY_INFO_OVERRIDE_PROGRAM_NAME
	string "Generate string for program name in binary info"
	depends on RPI_PICO_BINARY_INFO_PROGRAM_NAME

config RPI_PICO_BINARY_INFO_PROGRAM_URL
	bool "Generate program url in binary info"

config RPI_PICO_BINARY_INFO_OVERRIDE_PROGRAM_URL
	string "String for program description in binary info"
	depends on RPI_PICO_BINARY_INFO_PROGRAM_URL

config RPI_PICO_BINARY_INFO_PROGRAM_DESCRIPTION
	bool "Generate program descrpition in binary info"

config RPI_PICO_BINARY_INFO_OVERRIDE_PROGRAM_DESCRIPTION
	string "String for program description in binary info"
	depends on RPI_PICO_BINARY_INFO_PROGRAM_DESCRIPTION

config RPI_PICO_BINARY_INFO_PROGRAM_BUILD_DATE
	bool "Generate build date in binary info"

config RPI_PICO_BINARY_INFO_OVERRIDE_PROGRAM_BUILD_DATE
	string "Generate string for build date in binary info"
	depends on RPI_PICO_BINARY_INFO_PROGRAM_BUILD_DATE

config RPI_PICO_BINARY_INFO_PROGRAM_VERSION_STRING
	bool "Generate program version in binary info"
	default y

config RPI_PICO_BINARY_INFO_SDK_VERSION_STRING
	bool "Generate sdk version in binary info"
	default y

config RPI_PICO_BINARY_INFO_PICO_BOARD
	bool "Generate board in binary info"
	default y

config RPI_PICO_BINARY_INFO_ATTRIBUTE_BUILD_TYPE
	bool "Generate 'purogram_build_attribute' in binary info"
	default y

config RPI_PICO_BINARY_INFO_BOOT_STAGE2_NAME
	bool "Generate board in binary info"
	default y

config RPI_PICO_BINARY_INFO_PINS_WITH_FUNC
	bool "Generate board in binary info"
	default y

endif
```

## soc/renesas/ra/ra2a1/Kconfig
```kconfig
# Copyright (c) 2023 TOKITA Hiroshi <tokita.hiroshi@fujitsu.com>
# SPDX-License-Identifier: Apache-2.0

config SOC_SERIES_RA2A1
	select ARM
	select CPU_CORTEX_M23
	select CPU_HAS_ARM_MPU
	select CPU_CORTEX_M_HAS_VTOR
	select CPU_CORTEX_M_HAS_SYSTICK
	select DYNAMIC_INTERRUPTS
	select TIMER_READS_ITS_FREQUENCY_AT_RUNTIME
	select XIP
```

## soc/renesas/ra/ra2a1/Kconfig.defconfig
```kconfig
# Copyright (c) 2024 TOKITA Hiroshi
# SPDX-License-Identifier: Apache-2.0

if SOC_SERIES_RA2A1

config NUM_IRQS
	default 32

config PINCTRL
	default y

config GEN_ISR_TABLES_SCIRPT
	string
	default "${ZEPHYR_BASE}/soc/renesas/ra/common/gen_isr_tables.py"

endif # SOC_SERIES_RA2A1
```

## soc/renesas/ra/ra2a1/Kconfig.soc
```kconfig
# Copyright (c) 2023 TOKITA Hiroshi <tokita.hiroshi@fujitsu.com>
# SPDX-License-Identifier: Apache-2.0

config SOC_SERIES_RA2A1
	bool
	select SOC_FAMILY_RENESAS_RA
	help
	  Renesas RA2A1

config SOC_R7FA2A1AB3CFM
	bool
	select SOC_SERIES_RA2A1
	help
          R7FA2A1AB3CFM

config SOC_SERIES
	default "ra2a1" if SOC_SERIES_RA2A1

config SOC
	default "r7fa2a1ab3cfm" if SOC_R7FA2A1AB3CFM


config OPTION_SETTING_MEMORY
       bool "Option Setting Memory"
       default y

config OPTION_SETTING_LVDAS_DISABLE
       bool "Disable voltage monitor 0 after reset"
       default y
       depends on OPTION_SETTING_MEMORY

config OPTION_SETTING_HOCO_DISABLE
       bool "Disable HOCO oscillator after reset"
       default n
       depends on OPTION_SETTING_MEMORY

config OPTION_SETTING_HOCO_FREQ
       int "HOCO oscillator frequency"
       default 48000000
       depends on OPTION_SETTING_MEMORY

config OPTION_SETTING_VDSEL
       int "Voltage Detection 0 Level Select"
       default 1900
       depends on OPTION_SETTING_MEMORY
```

## soc/riscv/gigadevice-gd32vf103/Kconfig.soc
```kconfig
# RISCV_GIGADEVICE_GD32VF103 SOC configuration options

# Copyright (c) 2017 Jean-Paul Etienne <fractalclone@gmail.com>
# SPDX-License-Identifier: Apache-2.0

config SOC_RISCV_GIGADEVICE_GD32VF103
	bool "GigaDevice GD32VF103 SOC implementation"
	select ATOMIC_OPERATIONS_C
	select RISCV
```

## soc/riscv/riscv-privilege/gd_gd32vf103/Kconfig.defconfig.series
```kconfig
if SOC_SERIES_GD_GD32VF103

config SOC_SERIES
        default "gd_gd32vf103"

endif # SOC_SERIES_GD32VF103



if SOC_GD_GD32VF103

config SOC
        default "gd_gd32vf103"

config KERNEL_ENTRY
	default "__nuclei_start"

config SYS_CLOCK_HW_CYCLES_PER_SEC
        default 108000000

config RISCV_MACHINE_TIMER_SYSTEM_CLOCK_DIVIDER
	default 4

config RISCV_SOC_MCAUSE_EXCEPTION_MASK
	default 0x7ff

config RISCV_SOC_INTERRUPT_INIT
	default y

config RISCV_HAS_CPU_IDLE
	default y

config RISCV_GP
	default y

config RISCV_HAS_PLIC
	default n

config NUM_IRQS
	default 87 if  NUCLEI_ECLIC
	default 16 if !NUCLEI_ECLIC

endif
```

## soc/riscv/riscv-privilege/gd_gd32vf103/Kconfig.series
```kconfig
# GD32VF103 SOC implementation

# Copyright (c) 2021 Tokita, Hiroshi <tokita.hiroshi@gmail.com>
# SPDX-License-Identifier: Apache-2.0

config SOC_SERIES_GD_GD32VF103
	bool "GigaDevice GD32VF103 series SoC implementation"
	select RISCV
	select SOC_FAMILY_RISCV_PRIVILEGE
	select INCLUDE_RESET_VECTOR
	select BUILD_OUTPUT_HEX
	select XIP
	select RISCV_HAS_CLIC

	help
	  Enable support for GigaDevice GD32VF1 series SoC
```

## soc/riscv/riscv-privilege/gigadevice-gd32v/Kconfig.series
```kconfig
# SERIES_RISCV_GIGADEVICE_GD32V SOC implementation

# Copyright (c) 2021 Tokita, Hiroshi <tokita.hiroshi@gmail.com>
# SPDX-License-Identifier: Apache-2.0

config SOC_SERIES_RISCV_GIGADEVICE_GD32V
	bool "GigaDevice GD32VF103 series SoC implementation"
	select RISCV
	select SOC_FAMILY_RISCV_PRIVILEGE
	help
	  Enable support for GigaDevice GD32V series SoC
```

## soc/riscv/riscv-privilege/gigadevice-gd32vf103/Kconfig.defconfig.series
```kconfig
# SPDX-License-Identifier: Apache-2.0

if SOC_SERIES_RISCV_GIGADEVICE_GD32VF103

config SOC_SERIES
	default "gigadevice-gd32vf103"

config SYS_CLOCK_HW_CYCLES_PER_SEC
	default 32768

config RISCV_SOC_INTERRUPT_INIT
	default y

config RISCV_HAS_CPU_IDLE
	default y

config PLIC
	default n

config NUCLEI_ECLIC
	default y

config NUM_IRQS
	default 64

config XIP
	default y

if GPIO

config GPIO_GD32
	default y

config GPIO_GD32_PORTA
	default y

config GPIO_GD32_PORTB
	default y

config GPIO_GD32_PORTC
	default y

config GPIO_GD32_PORTD
	default y

config GPIO_GD32_PORTE
	default y

endif # GPIO


if SERIAL

config UART_GD32
	default y

endif

endif # SOC_SERIES_RISCV_GIGADEVICE_GD32VF103
```

## soc/riscv/riscv-privilege/gigadevice-gd32vf103/Kconfig.series
```kconfig
# RISCV_GIGADEVICE_GD32VF103 SOC implementation

# Copyright (c) 2017 Jean-Paul Etienne <fractalclone@gmail.com>
# SPDX-License-Identifier: Apache-2.0

config SOC_SERIES_RISCV_GIGADEVICE_GD32VF103
	bool "GigaDevice GD32VF103 SOC implementation"
	depends on RISCV
	select SOC_FAMILY_RISCV_PRIVILEGE
	help
	  Enable support for GigaDevice GD32VF103 SOC
```

## soc/riscv/riscv-privilege/gigadevice-gd32vf103/Kconfig.soc
```kconfig
# RISCV_GIGADEVICE_GD32VF103 SOC configuration options

# Copyright (c) 2017 Jean-Paul Etienne <fractalclone@gmail.com>
# SPDX-License-Identifier: Apache-2.0

choice
	prompt "GigaDevice GD32VF103 SOC implementation"
	depends on SOC_SERIES_RISCV_GIGADEVICE_GD32VF103

config SOC_RISCV_GIGADEVICE_GD32VF103
	bool "GigaDevice GD32VF103 SOC implementation"
	select ATOMIC_OPERATIONS_C

endchoice
```

## soc/riscv/riscv-privileged/qingke/Kconfig.defconfig.series
```kconfig
# Copyright (c) 2023 Chen Xingyu <hi@xingrz.me>
# SPDX-License-Identifier: Apache-2.0

if SOC_SERIES_QINGKE

config SOC_SERIES
	default "qingke"

config RISCV_GP
	default y

source "soc/riscv/riscv-privileged/qingke/Kconfig.defconfig.ch*"

endif # SOC_SERIES_QINGKE
```

## soc/riscv/riscv-privileged/qingke/Kconfig.soc
```kconfig
# Copyright (c) 2023 Chen Xingyu <hi@xingrz.me>
# SPDX-License-Identifier: Apache-2.0

config SOC_SERIES_QINGKE
	bool
	select RISCV
	select RISCV_HAS_CLIC
	select SOC_FAMILY_RISCV_PRIVILEGED
	select INCLUDE_RESET_VECTOR
	select ATOMIC_OPERATIONS_C

source "soc/riscv/riscv-privileged/qingke/Kconfig.soc.*"
```

## soc/xen/Kconfig
```kconfig
# Copyright 2020 EPAM Systems
# SPDX-License-Identifier: Apache-2.0

config SOC_XENVM
        select ARM64
        select ARM_ARCH_TIMER if SYS_CLOCK_EXISTS
        select CPU_CORTEX_A72

config SOC_XENVM_R52
        select ARM
        select ARM_ARCH_TIMER if SYS_CLOCK_EXISTS
        select ARM_MPU
        select CPU_HAS_ARM_MPU
        select CPU_CORTEX_R52
```

## soc/xen/Kconfig.soc
```kconfig
# Copyright 2020 EPAM Systems
# SPDX-License-Identifier: Apache-2.0

config SOC_XENVM
        bool

config SOC_XENVM_R52
        bool

config SOC
        default "xenvm" if SOC_XENVM
        default "xenvm_r52" if SOC_XENVM_R52
```

## tests/drivers/build_all/bbram/testcase.yaml
```yaml
# Copyright (c) 2024 TOKITA hiroshi
# SPDX-License-Identifier: Apache-2.0

tests:
  drivers.bbram.build:
    tags:
      - drivers
      - bbram
    build_only: true
    platform_allow:
      - native_sim

  drivers.bbram.emul.build:
    tags:
      - drivers
      - bbram
    build_only: true
    platform_allow:
      - native_sim
    extra_configs:
      - CONFIG_EMUL=y
```

## tests/drivers/build_all/display/testcase.yaml
```yaml
common:
  tags:
    - drivers
    - display
  build_only: true
  platform_allow:
    - native_posix
    - native_sim
tests:
  drivers.display.default:
    extra_configs:
      - CONFIG_DISPLAY_NT35510_INIT_PRIORITY=87
      - CONFIG_DISPLAY_OTM8009A_INIT_PRIORITY=87
```

## tests/drivers/build_all/flash/testcase.yaml
```yaml
# Copyright (c) 2024 TOKITA hiroshi
# SPDX-License-Identifier: Apache-2.0

tests:
  drivers.flash.build:
    tags:
      - drivers
      - flash
    build_only: true
    platform_allow:
      - native_sim

  drivers.flash.emul.build:
    tags:
      - drivers
      - flash
    build_only: true
    platform_allow:
      - native_sim
    extra_configs:
      - CONFIG_EMUL=y
```

## tests/drivers/build_all/i2c/testcase.yaml
```yaml
common:
  build_only: true
  tags:
    - drivers
    - i2c
tests:
  drivers.i2c.build:
    # will cover drivers without in-tree boards
    platform_allow:
      - qemu_cortex_m3
      - native_sim
      - native_sim/native/64
    extra_configs:
      - CONFIG_I2C_TCA954X_ROOT_INIT_PRIO=61
      - CONFIG_I2C_TCA954X_CHANNEL_INIT_PRIO=62
```

## tests/drivers/build_all/lora/testcase.yaml
```yaml
tests:
  sample.driver.lora.rylr.send:
    extra_args: SHIELD=reyax_lora
    platform_allow: cy8ckit_062s4
  sample.driver.lora.build.uart:
    build_only: true
    extra_args: DTC_OVERLAY_FILE="uart_devices.overlay"
    extra_configs:
      - CONFIG_SERIAL=y
    platform_allow:
      - native_posix
      - native_posix/native/64
      - native_sim
      - native_sim/native/64
  sample.driver.lora.build.spi:
    build_only: true
    extra_args: DTC_OVERLAY_FILE="spi_devices.overlay"
    extra_configs:
      - CONFIG_SPI=y
    platform_allow:
      - native_posix
      - native_posix/native/64
      - native_sim
      - native_sim/native/64
```

## tests/drivers/build_all/power_domain/testcase.yaml
```yaml
common:
  build_only: true
  tags:
    - drivers
    - power_domain
tests:
  drivers.power_domain.build:
    platform_allow:
      - native_sim
      - native_sim/native/64
```
