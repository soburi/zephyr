## arch/arm64/core/xen/Kconfig
```kconfig
# Xen hypervisor configuration options

# Copyright (c) 2023 EPAM Systems
# SPDX-License-Identifier: Apache-2.0

config XEN
	bool
	default y
	depends on ARMV8_A
	depends on DT_HAS_XEN_XEN_ENABLED
	help
	  Enables support of Xen hypervisor on arm64 platform. Get enabled
	  when board device tree contains "hypervisor" node with "xen,xen"
	  compatible enabled.

config XEN_DOM0
	bool "Zephyr as Xen Domain 0"
	depends on XEN
	help
	  Built binary will be used as Xen privileged domain (Domain 0).

config XEN_DOM0LESS
	bool "Zephyr for Xen Dom0less setup"
	depends on XEN && !XEN_DOM0
	help
	  Configures Zephyr as DomU, that can be started on Dom0less
	  setup.

config XEN_INTERFACE_VERSION
	hex "Xen interface version"
	default 0x00040e00
	depends on XEN
	help
	  Xen interface version to use. This is the version of the
	  interface that Zephyr will use to communicate with the hypervisor.

config XEN_DOMCTL_INTERFACE_VERSION
	hex "Xen Domctl interface version"
	default 0x17
	range 0x15 0x17
	depends on XEN
	help
	  Xen Domctl interface version to use. This is the version of the
	  domctl interface that Zephyr will use to communicate with
	  the hypervisor. The default value is the latest version supported
	  by the kernel.

config XEN_SYSCTL_INTERFACE_VERSION
	hex "Xen Sysctl interface version"
	default 0x15
	range 0x15 0x15
	depends on XEN
	help
	  Xen Sysctl interface version to use. This is the version of the
	  domctl interface that Zephyr will use to communicate with
	  the hypervisor. The default value is the latest version supported
	  by the kernel.

config XEN_DOMCTL_XENTROOPS_ARCH_VGSX_OSID
	bool "OSID used by virtual GSX device"
	default n
	depends on XEN
	help
	  Pass vGSX OSID when creating domain in struct xen_arch_domainconfig.
	  Having matching OSID <-> DomID in place, Xen can properly recognize
	  to what domain to inject GSX irq.
	  Note. It is custom Xen property which is not maintained by Xen community.

config XEN_DOMCTL_XENTROOPS_ARCH_SCI_TYPE
	bool "SCI mediator framework type"
	default n
	depends on XEN
	help
	  SCI mediator framework type for creating domain in struct
	  xen_arch_domainconfig.
	  Note. It is custom Xen property which is not maintained by Xen community.
```

## boards/arm/fpb_ra6e1/Kconfig.board
```kconfig
# Copyright (c) 2023 TOKITA Hiroshi <tokita.hiroshi@fujitsu.com>
# SPDX-License-Identifier: Apache-2.0

config BOARD_FPB_RA6E1
	bool "RA6E1 Fast Prototyping Board"
	depends on SOC_R7FA6E10F2CFP
```

## boards/arm/fpb_ra6e1/Kconfig.defconfig
```kconfig
# Copyright (c) 2023 TOKITA Hiroshi <tokita.hiroshi@fujitsu.com>
# SPDX-License-Identifier: Apache-2.0

if BOARD_FPB_RA6E1

config BOARD
	default "fpb_ra6e1" if BOARD_FPB_RA6E1

endif # BOARD_FPB_RA6E1
```

## boards/arm/fpb_ra6e1/fpb_ra6e1_defconfig
```kconfig
# Copyright (c) 2023 TOKITA Hiroshi <tokita.hiroshi@fujitsu.com>
# SPDX-License-Identifier: Apache-2.0

CONFIG_SOC_SERIES_RA6E1=y
CONFIG_SOC_R7FA6E10F2CFP=y

CONFIG_SYS_CLOCK_HW_CYCLES_PER_SEC=166666666

CONFIG_BUILD_OUTPUT_HEX=y

# enable uart driver
CONFIG_SERIAL=y

# enable console
CONFIG_CONSOLE=y
CONFIG_UART_CONSOLE=y

# enable GPIO
CONFIG_GPIO=y

CONFIG_PINCTRL=y

CONFIG_CLOCK_CONTROL=y
```

## boards/arm/raytac_mdbt50q_rx/Kconfig.board
```kconfig
# nRF52840 DK NRF52840 board configuration

# Copyright (c) 2016 Nordic Semiconductor ASA
# SPDX-License-Identifier: Apache-2.0

config BOARD_RAYTAC_MDBT50Q_RX
	bool "Raytac MDBT50Q-RX"
	depends on SOC_NRF52840_QIAA
```

## boards/arm/raytac_mdbt50q_rx/Kconfig.defconfig
```kconfig
# nRF52840 DK NRF52840 board configuration

# Copyright (c) 2016 Nordic Semiconductor ASA
# SPDX-License-Identifier: Apache-2.0

if BOARD_RAYTAC_MDBT50Q_RX

config BOARD
	default "raytac_mdbt50q_rx"

if USB

config USB_NRFX
	default y

config USB_DEVICE_STACK
	default y

endif # USB

config BT_CTLR
	default BT

endif # BOARD_NRF52840DK_NRF52840
```

## boards/m5stack/m5stack_cores3/Kconfig
```kconfig
# Copyright (c) 2024 Zhang Xingtao <zhxt@live.cn>
# SPDX-License-Identifier: Apache-2.0

config HEAP_MEM_POOL_ADD_SIZE_BOARD
	int
	default 4096 if BOARD_M5STACK_CORES3_ESP32S3_PROCPU || \
			BOARD_M5STACK_CORES3_ESP32S3_PROCPU_SE
	default 256 if BOARD_M5STACK_CORES3_ESP32S3_APPCPU

config M5STACK_CORES3_AW9523_INIT_PRIORITY
	int "AW9523B board setup init priority"
	depends on GPIO_AW9523B
	range 0 99
	default 70
	help
	  Controls the init priority of the board-specific AW9523B configuration.
	  This should be lower than CONFIG_DISPLAY_INIT_PRIORITY so that the GPIO
	  expander is ready before the display driver probes.
```

## boards/m5stack/m5stack_cores3/Kconfig.defconfig
```kconfig
# M5Stack CoreS3 board defconfig

# Copyright (c) 2024 TOKITA Hiroshi
# SPDX-License-Identifier: Apache-2.0

if BOARD_M5STACK_CORES3_ESP32S3_PROCPU || BOARD_M5STACK_CORES3_ESP32S3_PROCPU_SE

config DISPLAY
	default y

config INPUT
	default y

if MIPI_DBI

config MIPI_DBI_INIT_PRIORITY
	default 82

endif # MIPI_DBI

endif # BOARD_M5STACK_CORES3_ESP32S3_PROCPU || BOARD_M5STACK_CORES3_ESP32S3_PROCPU_SE
```

## boards/m5stack/m5stack_cores3/board.yml
```yaml
board:
  name: m5stack_cores3
  full_name: CoreS3
  vendor: m5stack
  revision:
    format: "custom"
    default: "standard"
    revisions:
    - name: "standard"
    - name: "se"
  socs:
  - name: esp32s3
```

## boards/m5stack/m5stack_cores3/m5stack_cores3_appcpu_standard_defconfig
```kconfig
# SPDX-License-Identifier: Apache-2.0

CONFIG_MAIN_STACK_SIZE=2048
CONFIG_BUILD_OUTPUT_HEX=y
CONFIG_CLOCK_CONTROL=y
```

## boards/m5stack/m5stack_cores3/m5stack_cores3_procpu_se_defconfig
```kconfig
# SPDX-License-Identifier: Apache-2.0

CONFIG_CONSOLE=y
CONFIG_SERIAL=y
CONFIG_UART_CONSOLE=y
CONFIG_GPIO=y
CONFIG_GPIO_AW9523B_DUMP_REGS=y
CONFIG_MFD_AXP2101_DUMP_REGS=y
```

## boards/m5stack/m5stack_cores3/m5stack_cores3_procpu_standard_defconfig
```kconfig
# SPDX-License-Identifier: Apache-2.0

CONFIG_MAIN_STACK_SIZE=2048
CONFIG_BUILD_OUTPUT_HEX=y
CONFIG_CONSOLE=y
CONFIG_SERIAL=y
CONFIG_UART_CONSOLE=y
CONFIG_GPIO=y
```

## boards/riscv/sipeed_longan_nano/Kconfig.board
```kconfig
config BOARD_SIPEED_LONGAN_NANO
        bool "Sipeed Longan Nano target"
        #select QEMU_TARGET
	#select CPU_HAS_FPU
        #select RISCV_ISA_RV32I
```

## boards/riscv/sipeed_longan_nano/sipeed_longan_nano_defconfig
```kconfig
CONFIG_BOARD_SIPEED_LONGAN_NANO=y
CONFIG_SOC_SERIES_GD_GD32VF103=y
CONFIG_SOC_GD_GD32VF103=y
```

## boards/riscv/sipeed_longan_nano/sipeed_longan_nano_lite_defconfig
```kconfig
# Sipeed longan nano Development Board Configuration
#
# Copyright (c) 2019, embedjournal.com
#
# SPDX-License-Identifier: Apache-2.0
#

CONFIG_SOC_SERIES_RISCV_GIGADEVICE_GD32VF103=y
CONFIG_SOC_RISCV_GIGADEVICE_GD32VF103=y
CONFIG_BOARD_SIPEED_LONGAN_NANO_LITE=y

# 108MHz system clock
CONFIG_SYS_CLOCK_HW_CYCLES_PER_SEC=108000000
CONFIG_RISCV_MACHINE_TIMER_CLOCK_FREQUENCY=27000000
CONFIG_RISCV_MACHINE_TIMER=y

CONFIG_RISCV_SOC_MCAUSE_EXCEPTION_MASK=0x7FF
```

## boards/seeed/wio_lite_riscv/Kconfig.defconfig
```kconfig
# Copyright (c) 2023 Tada, Hiroki <hirokin18931@gmail.com>

if BOARD_WIO_LITE_RISCV

config DISK_DRIVER_SDMMC
        default y if DISK_DRIVERS

endif # BOARD_WIO_LITE_RISCV
```

## boards/seeed/wio_lite_riscv/Kconfig.wio_lite_riscv
```kconfig
# Copyright (c) 2023 Tada Hiroki <hirokin18931@gmail.com>
# SPDX-License-Identifier: Apache-2.0

config BOARD_WIO_LITE_RISCV
	select SOC_GD32VF103
```

## boards/seeed/wio_lite_riscv/wio_lite_riscv_defconfig
```kconfig
# Sipeed longan nano Development Board Configuration
#
# Copyright (c) 2023 Tada, Hiroki <hirokin18931@gmail.com>
#
# SPDX-License-Identifier: Apache-2.0

CONFIG_GD32_HXTAL_8MHZ=y

CONFIG_SERIAL=y
CONFIG_UART_INTERRUPT_DRIVEN=y

CONFIG_CONSOLE=y
CONFIG_UART_CONSOLE=y

CONFIG_GPIO=y
```

## boards/shields/cqpub_pico_trainer/Kconfig.defconfig
```kconfig
if SHIELD_CQPUB_PICO_TRAINER || SHIELD_CQPUB_PICO_TRAINER_WAVESHARE_19376

if DISK_ACCESS

config SDHC
	default y

config DISK_DRIVER_SDMMC
	default y

endif

if NETWORKING

config NET_L2_ETHERNET
	default y

endif

endif # CQPUB_PICO_TRAINER
```

## boards/shields/cqpub_pico_trainer/Kconfig.shield
```kconfig
config SHIELD_CQPUB_PICO_TRAINER
	def_bool $(shields_list_contains,cqpub_pico_trainer)

config SHIELD_CQPUB_PICO_TRAINER_WAVESHARE_19376
	def_bool $(shields_list_contains,cqpub_pico_trainer_waveshare_19376)
```

## boards/shields/soburi_pico_trainer/Kconfig.defconfig
```kconfig
if SHIELD_SOBURI_PICO_TRAINER

config SPI
	default y

config I2C
	default y

config ADC
	default y

if DISPLAY

config SSD1306
	default y

endif

if DISK_ACCESS

config SDHC
	default y

config DISK_DRIVER_SDMMC
	default y

endif

if NETWORKING

config NET_L2_ETHERNET
        default y

config ETH_ENC28J60
	default y

config ETH_ENC28J60_0
	default y

endif

endif # SOBURI_PICO_TRAINER
```

## boards/shields/soburi_pico_trainer/Kconfig.shield
```kconfig
config SHIELD_SOBURI_PICO_TRAINER
	def_bool $(shields_list_contains,soburi_pico_trainer)
```
